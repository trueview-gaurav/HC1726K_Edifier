## bsp/sdk/bootloader/uboot/arch/arm/cpu/armv7/hc1703_1723_1753_1783s/Kconfig
```kconfig
if ARCH_HC1703_1723_1753_1783S

config SYS_SOC
	default "hc1703_1723_1753_1783s"

config SYS_CPU
	default "armv7"

choice # Product select
	prompt "Augentix product select"
	optional

config TARGET_HC1783S_TB006
	bool "Test product HC1783S_TB006"

config TARGET_HC1783S_TB006_NOR
	bool "Test product HC1783S_TB006 with NOR flash support"

config TARGET_HC1783S_TB006_NOR_8MB
	bool "Test product HC1783S_TB006_8MB with NOR flash support"

config TARGET_HC1783S_FPU_TB006_NOR_8MB
	bool "Test product HC1783S_FPU_TB006_8MB with NOR flash support"

config TARGET_HC1783S_TB006_SLT
	bool "Test product HC1783S_TB006 for SLT"

config TARGET_HC1703_TB008
	bool "Test product HC1703_TB008"

config TARGET_HC1703_TB008_NOR
	bool "Test product HC1703_TB008 with NOR flash support"

config TARGET_HC1703_TB008_NOR_8MB
	bool "Test product HC1703_TB008_8MB with NOR flash support"

config TARGET_HC1703_TB008_SLT
	bool "Test product HC1703_TB008 for SLT"

config TARGET_HC1703L_TB008_SLT
	bool "Test product HC1703L_TB008 for SLT"

config TARGET_HC1703L_TB008_NOR_8MB
	bool "Test product HC1703L_TB008_8MB with NOR flash support"

config TARGET_HC1703L_MB021_NOR_8MB
	bool "Test product HC1703L_MB021_8MB with NOR flash support"

config TARGET_HC1705_TB008_SLT
	bool "Test product HC1705_TB008 for SLT"

config TARGET_HC1705_MB021_NOR_8MB
	bool "Test product HC1705_MB021_8MB with NOR flash support"

config TARGET_HC1705_MB026_NOR_8MB
	bool "Test product HC1705_MB026_8MB with NOR flash support"

config TARGET_HC1705I_TB008_SLT
	bool "Test product HC1705I_TB008 for SLT"

config TARGET_HC1705K_TB008_SLT
	bool "Test product HC1705K_TB008 for SLT"

config TARGET_HC1715_TB007_SLT
	bool "Test product HC1715_TB007 for SLT"

config TARGET_HC1725_TB007_SLT
	bool "Test product HC1725_TB007 for SLT"

config TARGET_HC1725_MB023_NOR_8MB
	bool "Test product HC1725_MB023_NOR_8MB with NOR flash support"

config TARGET_HC1725_FPU_TB007_SLT
	bool "Test product HC1725_FPU_TB007 for SLT"

config TARGET_HC1725_FPU_MB023_NOR_8MB
	bool "Test product HC1725_FPU_MB023_NOR_8MB with NOR flash support"

config TARGET_HC1725S_TB006_SLT
	bool "Test product HC1725S_TB006 for SLT"

config TARGET_HC1723_TB007
	bool "Test product HC1723_TB007"

config TARGET_HC1723_TB007_SLT
	bool "Test product HC1723_TB007 for SLT"

config TARGET_HC1723_MB023_NOR_8MB
	bool "Test product HC1723_MB023_NOR_8MB with NOR flash support"

config TARGET_HC1753_TB007
	bool "Test product HC1753_TB007"

config TARGET_HC1753_TB007_SLT
	bool "Test product HC1753_TB007 for SLT"

config TARGET_HC1753_FPU_MB023_NOR_16MB
	bool "Test product HC1753_FPU_MB023_16MB with NOR flash support"

config TARGET_HC1753S_TB006_SLT
	bool "Test product HC1753S_TB006 for SLT"

config TARGET_AGT001_22
	bool "AGT001-22"

config TARGET_AGT001_23
	bool "AGT001-23"

config TARGET_AGT001_27
        bool "AGT001-27"

config TARGET_AGT001_28
	bool "AGT001-28"

config TARGET_AGT001_29
	bool "AGT001-29"

config TARGET_AGT007_21
	bool "AGT007-21"

config TARGET_AGT200_20
	bool "AGT200-20"

config TARGET_AGT200_21
	bool "AGT200-21"

config TARGET_AGT783_2
	bool "AGT783-2"

config TARGET_AGT800_20
	bool "AGT800-20"

config TARGET_AGT800_22
	bool "AGT800-22"

config TARGET_AGT800_23
	bool "AGT800-23"

config TARGET_AGT001_24
	bool "AGT001-24"

config TARGET_AGT300_22
	bool "AGT300-22"

config TARGET_AGT725_3
	bool "AGT725-3"

config TARGET_AGT725_10
	bool "AGT725-10"

config TARGET_AGT725_12
	bool "AGT725-12"

config TARGET_AGT300_23
	bool "AGT300-23"

config TARGET_AGT300_27
	bool "AGT300-27"

config TARGET_AGT300_28
	bool "AGT300-28"

config TARGET_AGT300_29
	bool "AGT300-29"

config TARGET_AGT800_27
	bool "AGT800-27"

config TARGET_AGT800_30
	bool "AGT800-30"

config TARGET_AGT800_31
	bool "AGT800-31"

config TARGET_AGT800_32
	bool "AGT800-32"

config TARGET_AGT800_33
	bool "AGT800-33"

config TARGET_AGT800_34
	bool "AGT800-34"

config TARGET_AGT800_35
	bool "AGT800-35"

config TARGET_AGT800_36
	bool "AGT800-36"

config TARGET_AGT800_37
        bool "AGT800-37"

config TARGET_AGT800_38
        bool "AGT800-38"

config TARGET_AGT800_39
        bool "AGT800-39"

config TARGET_AGT800_42
        bool "AGT800-42"

config TARGET_AGT800_45
        bool "AGT800-45"

config TARGET_AGT803_20
	bool "AGT803-20"

config TARGET_AGT804_20
	bool "AGT804-20"

config TARGET_AGT804_25
	bool "AGT804-25"

config TARGET_AGT804_27
	bool "AGT804-27"

config TARGET_AGT804_30
	bool "AGT804-30"

config TARGET_AGT804_31
	bool "AGT804-31"

config TARGET_AGT804_35
        bool "AGT804-35"

config TARGET_AGT804_37
        bool "AGT804-37"

config TARGET_AGT804_38
        bool "AGT804-38"

config TARGET_AGT804_39
        bool "AGT804-39"

config TARGET_AGT804_42
        bool "AGT804-42"

config TARGET_AGT804_43
        bool "AGT804-43"

config TARGET_AGT804_45
	bool "AGT804-45"

config TARGET_AGT804_46
        bool "AGT804-46"

config TARGET_AGT100_21
        bool "AGT100-21"

config TARGET_AGT100_22
        bool "AGT100-22"

config TARGET_AGT100_23
        bool "AGT100-23"

config TARGET_AGT100_24
        bool "AGT100-24"

config TARGET_AGT100_27
        bool "AGT100-27"

config TARGET_AGT100_28
        bool "AGT100-28"

config TARGET_AGT301_20
        bool "AGT301-20"

config TARGET_AGT201_20
        bool "AGT201-20"

config TARGET_AGT100_29
        bool "AGT100-29"

config TARGET_AGT300_25
        bool "AGT300-25"

config TARGET_AGT100_30
        bool "AGT100-30"

config TARGET_AGT300_26
        bool "AGT300-26"

config TARGET_AGT201_22
        bool "AGT201-22"

config TARGET_AGT800_40
        bool "AGT800-40"

config TARGET_AGT800_41
        bool "AGT800-41"

config TARGET_AGT800_46
        bool "AGT800-46"

config TARGET_AGT100_25
        bool "AGT100-25"

config TARGET_AGT804_48
        bool "AGT804-48"

config TARGET_AGT301_21
        bool "AGT301-21"

config TARGET_AGT100_31
        bool "AGT100-31"

config TARGET_AGT302_20
        bool "AGT302-20"

config TARGET_AGT201_23
        bool "AGT201-23"

config TARGET_AGT783_1
        bool "AGT783-1"

config TARGET_AGT725_2
        bool "AGT725-2"

config TARGET_AGT300_31
        bool "AGT300-31"

config TARGET_AGT300_30
        bool "AGT300-30"

config TARGET_AGT705_2
        bool "AGT705-2"

config TARGET_AGT705_3
        bool "AGT705-3"

config TARGET_AGT705_4
        bool "AGT705-4"

config TARGET_AGT705_6
        bool "AGT705-6"

config TARGET_AGT705_7
        bool "AGT705-7"

config TARGET_AGT804_49
        bool "AGT804-49"

config TARGET_AGT725_7
        bool "AGT725-7"
		
config TARGET_AGT725_6
        bool "AGT725-6"

config TARGET_AGT725_9
        bool "AGT725-9"

config TARGET_AGT725_11
        bool "AGT725-11"

config TARGET_AGT783_4
        bool "AGT783-4"

config TARGET_AGT301_23
        bool "AGT301-23"

config TARGET_HC1703_1723_1753_1783S
	bool "Generic design"

endchoice # Product select

# Augentix product level Kconfig
source "board/augentix/hc1703_1723_1753_1783s/Kconfig"
source "board/augentix/hc1783s-tb006/Kconfig"
source "board/augentix/hc1783s-tb006-nor/Kconfig"
source "board/augentix/hc1783s-tb006-nor-8mb/Kconfig"
source "board/augentix/hc1783s-tb006-slt/Kconfig"
source "board/augentix/hc1703-tb008/Kconfig"
source "board/augentix/hc1703-tb008-nor/Kconfig"
source "board/augentix/hc1703-tb008-nor-8mb/Kconfig"
source "board/augentix/hc1703-tb008-slt/Kconfig"
source "board/augentix/hc1703l-tb008-slt/Kconfig"
source "board/augentix/hc1703l-mb021-nor-8mb/Kconfig"
source "board/augentix/hc1715-tb007/Kconfig"
source "board/augentix/hc1705-tb008-slt/Kconfig"
source "board/augentix/hc1705i-tb008-slt/Kconfig"
source "board/augentix/hc1705k-tb008-slt/Kconfig"
source "board/augentix/hc1715-tb007-slt/Kconfig"
source "board/augentix/hc1725-tb007-slt/Kconfig"
source "board/augentix/hc1725-mb023-nor-8mb/Kconfig"
source "board/augentix/hc1725s-tb006-slt/Kconfig"
source "board/augentix/hc1723-tb007/Kconfig"
source "board/augentix/hc1723-tb007-slt/Kconfig"
source "board/augentix/hc1723-mb023-nor-8mb/Kconfig"
source "board/augentix/hc1753-tb007/Kconfig"
source "board/augentix/hc1753-tb007-slt/Kconfig"
source "board/augentix/hc1753s-tb006-slt/Kconfig"
source "board/augentix/agt-ma001027-v1/Kconfig"
source "board/augentix/agt-ma100027-v1/Kconfig"
source "board/augentix/agt-ma100030-v1/Kconfig"
source "board/augentix/agt-ma300027-v1/Kconfig"
source "board/augentix/agt-ma300028-v1/Kconfig"
source "board/augentix/agt-ma300029-v1/Kconfig"
source "board/augentix/agt-ma200021-v1/Kconfig"
source "board/augentix/agt-ma705003-v1/Kconfig"
source "board/augentix/agt-ma705004-v1/Kconfig"
source "board/augentix/agt-ma705006-v1/Kconfig"
source "board/augentix/agt-ma705007-v1/Kconfig"
source "board/augentix/agt-ma725012-v1/Kconfig"
source "board/augentix/agt-ma800020-v1/Kconfig"
source "board/augentix/agt-ma800022-v1/Kconfig"
source "board/augentix/agt-ma800027-v1/Kconfig"
source "board/augentix/agt-ma800033-v1/Kconfig"
source "board/augentix/agt-ma800038-v1/Kconfig"
source "board/augentix/agt-ma800045-v1/Kconfig"
source "board/augentix/agt-ma800046-v1/Kconfig"
source "board/augentix/agt-ma804020-v1/Kconfig"
source "board/augentix/agt-ma804025-v1/Kconfig"
source "board/augentix/agt-ma804027-v1/Kconfig"
source "board/augentix/agt-ma804042-v1/Kconfig"
source "board/augentix/agt-ma804046-v1/Kconfig"
source "board/augentix/agt-ma001028-v1/Kconfig"
source "board/augentix/agt-ma001029-v1/Kconfig"
source "board/augentix/hc1723-mb023/Kconfig"
source "board/augentix/agt-ma804039-v1/Kconfig"
source "board/augentix/agt-ma804045-v1/Kconfig"
source "board/augentix/ihome1-ma804043-v3/Kconfig"
source "board/augentix/hc1725-mb023/Kconfig"
source "board/augentix/hc1725-tb007/Kconfig"
source "board/augentix/hc1705-mb021/Kconfig"
source "board/augentix/hc1705-mb026/Kconfig"
source "board/augentix/hc1783s-mb022/Kconfig"
source "board/augentix/hc1705-tb008/Kconfig"
source "board/augentix/hc1705k-tb008/Kconfig"
source "board/augentix/hc1705k-mb026/Kconfig"

endif #ARCH_HC1703_1723_1753_1783S
```

## bsp/sdk/bootloader/uboot/arch/arm/cpu/armv7/kamo/Kconfig
```kconfig
if ARCH_KAMO

config CPU_V7_HAS_NONSEC
	default y

config ARMV7_BOOT_SEC_DEFAULT
	default n

config SYS_SOC
	default "kamo"

config SYS_CPU
	default "armv7"

choice # Product select
	prompt "Augentix product select"
	optional

config TARGET_AGT705_8
	bool "AGT705-8"

config TARGET_KAMO
	bool "Generic design"

endchoice # Product select

# Augentix product level Kconfig
source "board/augentix/kamo/Kconfig"
source "board/augentix/hc1705l/Kconfig"

endif #ARCH_KAMO
```

## bsp/sdk/bootloader/uboot/arch/arm/cpu/armv7/osaka/Kconfig
```kconfig
if ARCH_OSAKA_32

config CPU_V7_HAS_NONSEC
	default y

config ARMV7_BOOT_SEC_DEFAULT
	default n

config SYS_SOC
	default "osaka"

config SYS_CPU
	default "armv7"

choice # Product select
	prompt "Augentix product select"
	optional

config TARGET_AGT785_1
	bool "AGT785-1"

config TARGET_OSAKA
	bool "Generic design"

endchoice # Product select

# Augentix product level Kconfig
source "board/augentix/osaka/Kconfig"
source "board/augentix/hc1785/Kconfig"

endif #ARCH_OSAKA_32
```

## bsp/sdk/bootloader/uboot/arch/arm/cpu/armv7/sapporo/Kconfig
```kconfig
if ARCH_SAPPORO

config CPU_V7_HAS_NONSEC
	default y

config ARMV7_BOOT_SEC_DEFAULT
	default n

config SYS_SOC
	default "sapporo"

config SYS_CPU
	default "armv7"

choice # Product select
	prompt "Augentix product select"
	optional

config TARGET_AGT706_1
	bool "AGT706-1"

config TARGET_AGT706_1_AMP
	bool "AGT706-1-amp"

config TARGET_AGT706_1_NAND
	bool "AGT706-1-nand"

config TARGET_AGT706_2
	bool "AGT706-2"

config TARGET_AGT706_2_NAND
	bool "AGT706-2-nand"

config TARGET_AGT706_3
	bool "AGT706-3"

config TARGET_AGT706_4
	bool "AGT706-4"

config TARGET_AGT706_5
	bool "AGT706-5"

config TARGET_AGT706_6
	bool "AGT706-6"

config TARGET_AGT706_7
	bool "AGT706-7"

config TARGET_AGT706_8
	bool "AGT706-8"

config TARGET_HC1706_TB010_SLT
	bool "HC1706-TB010-SLT"

config TARGET_HC1706H_TB010_SLT
	bool "HC1706H-TB010-SLT"

config TARGET_HC1706K_TB010_SLT
	bool "HC1706K-TB010-SLT"

config TARGET_HC1726_TB012_SLT
	bool "HC1726-TB012-SLT"

config TARGET_AGT706_9
	bool "AGT706-9"

config TARGET_AGT706_10
	bool "AGT706-10"

config TARGET_AGT706_13
	bool "AGT706-13"

config TARGET_AGT706_14
	bool "AGT706-14"

config TARGET_AGT706_15
	bool "AGT706-15"

config TARGET_AGT726_2
	bool "AGT726-2"

config TARGET_AGT726_1
	bool "AGT726-1"

config TARGET_AGT706_11
	bool "AGT706-11"

config TARGET_AGT706_12
	bool "AGT706-12"

config TARGET_AGT726_4
	bool "AGT726-4"

config TARGET_AGT726_3
	bool "AGT726-3"

config TARGET_AGT726_5
	bool "AGT726-5"

config TARGET_AGT726_7
	bool "AGT726-7"

config TARGET_AGT726_10
	bool "AGT726-10"

config TARGET_AGT726_12
	bool "AGT726-12"

config TARGET_AGT726_7
	bool "AGT726-7"

config TARGET_DFN202_113002
	bool "DFN202-113002"

config TARGET_AGT726_11
	bool "AGT726-11"

config TARGET_STR726_13
	bool "STR726-13"

config TARGET_SAPPORO
	bool "Generic design"

endchoice # Product select

# Augentix product level Kconfig
source "board/augentix/sapporo/Kconfig"
source "board/augentix/hc1706-tb010/Kconfig"
source "board/augentix/hc1706k-tb010/Kconfig"
source "board/augentix/hc1706k-mb033/Kconfig"
source "board/augentix/hc1706k-mb035/Kconfig"
source "board/augentix/hc1706h-mb033/Kconfig"
source "board/augentix/hc1726-tb012/Kconfig"
source "board/augentix/hc1726-tb013/Kconfig"

endif #ARCH_SAPPORO
```

## bsp/sdk/bootloader/uboot/arch/arm/cpu/armv8/osaka/Kconfig
```kconfig
if ARCH_OSAKA

config SYS_SOC
	default "osaka"

config SYS_CPU
	default "armv8"

choice # Product select
	prompt "Augentix product select"
	optional

config TARGET_AGT785_1
	bool "AGT785-1"

config TARGET_OSAKA
	bool "Generic design"

endchoice # Product select

# Augentix product level Kconfig
source "board/augentix/osaka/Kconfig"
source "board/augentix/hc1785/Kconfig"

endif #ARCH_OSAKA
```
