## bsp/buildroot/src/package/meson/Config.in.host
```kconfig
config BR2_PACKAGE_HOST_MESON
	bool "host meson"
        select BR2_PACKAGE_HOST_NINJA
	help
            Build the Meson build system as a host tool.
```

## bsp/buildroot/src/package/ncnn/Config.in
```kconfig
config BR2_PACKAGE_NCNN
	bool "ncnn"
	depends on BR2_INSTALL_LIBSTDCPP
	default y
	help
	  ncnn is pure C++ implementation.
	  https://github.com/Tencent/ncnn/
config BR2_PACKAGE_NCNN_COMPACT
	bool "ncnn_compact"
	depends on BR2_INSTALL_LIBSTDCPP
	default y
	help
	  ncnn is pure C++ implementation.
	  https://github.com/Tencent/ncnn/
config BR2_PACKAGE_NCNN_MINIMAL
	bool "ncnn_minimal"
	depends on BR2_INSTALL_LIBSTDCPP
	default y
	help
	  ncnn is pure C++ implementation.
	  https://github.com/Tencent/ncnn/
comment "ncnn support needs a toolchain with C++"
	depends on !BR2_INSTALL_LIBSTDCPP
```

## bsp/buildroot/src/package/ninja/Config.in.host
```kconfig
config BR2_PACKAGE_HOST_NINJA
    bool "host ninja"
    help
      Build the Ninja build system as a host tool.
```

## bsp/buildroot/src/package/pkcs11-provider/Config.in
```kconfig
config BR2_PACKAGE_PKCS11_PROVIDER
	bool "pkcs11-provider"
	depends on !BR2_STATIC_LIBS # dlfcn.h
	select BR2_PACKAGE_OPENSSL
	select BR2_PACKAGE_HOST_MESON
	select BR2_PACKAGE_HOST_NINJA
	help
	  https://github.com/OpenSC/pkcs11-helper

comment "pkcs11-helper needs a toolchain w/ dynamic library"
	depends on BR2_STATIC_LIBS
```

## bsp/buildroot/src/package/tensorflow/Config.in
```kconfig
config BR2_PACKAGE_TENSORFLOW
    bool "tensorflow"
    help
        A deep learning model inference c++ library

config BR2_PACKAGE_TENSORFLOW_LITE
    bool "tensorflow_lite"
    depends on BR2_PACKAGE_TENSORFLOW
    default y

config BR2_PACKAGE_TENSORFLOW_LITE_OPTIM
    bool "tensorflow_lite_optim"
    depends on BR2_PACKAGE_TENSORFLOW_LITE
    default y

config BR2_PACKAGE_TFLITE_BENCHMARK_TOOL
    bool "tensorflow_lite benchmark tool"
    depends on BR2_PACKAGE_TENSORFLOW_LITE
    default n

config BR2_PACKAGE_TENSORFLOW_MICROLITE
    bool "tensorflow_microlite"
    depends on BR2_PACKAGE_TENSORFLOW
    default y
```

## bsp/firmware/build/rule.make/product/hc1706h-agt706-11_defconfig
```kconfig
#CONFIG_HC1702_1752_1772_1782 is not set
#CONFIG_HC1703_1723_1753_1783S is not set
CONFIG_SAPPORO=y
#CONFIG_DUAL_OS is not set
CONFIG_UCLIBC=y

CONFIG_CHIP=HC1706H
CONFIG_MACH=hc1706h-agt706-11
CONFIG_PROD_AGT706_11=y
CONFIG_TARGET_CPU=cortex-a7
CONFIG_NVSP_LAYOUT="hc1706h-agt706-11.ini"
SENSOR=GC2083
SENSOR1=
LENS=YT0X7X61-A-HD+IR0764_CPSID100740
MOTHERBOARD=MB033
AUDIO_CODEC=adc


# Buildroot
BUILDROOT_DEFCONFIG=arm-augentix-linux-uclibcgnueabihf_defconfig

# Applications
APP_CONFIG=hc1706h-agt706-11_defconfig

# Sample demo
SAMPLE_DEMO_CONFIG=hc1706h-agt706-11_defconfig

# Sample tee demo
SAMPLE_OPTEE_CONFIG=hc1706h-agt706-11_defconfig

# Remote
REMOTE_CONFIG=hc1706h-agt706-11_defconfig

# AMPC
AMPC_CONFIG=hc1706h-agt706-11_defconfig

# Kernel
KERNEL_CONFIG=hc1706h-agt706-11_defconfig
#CONFIG_KERNEL_V6_1=y
CONFIG_UIMAGE_LOADADDR=0x01000000
# uimage compression support none, gzip, bzip2, lzma, lzo, lz4
CONFIG_UIMAGE_COMPRESS=none
#CONFIG_UIMAGE_DECOMPRESS_ADDR=0x00200000

# TEE
OPTEE_CONFIG=hc1706h-agt706-11_defconfig

# Audio
#CONFIG_AUDIO_DMIC_READY_DELAY is not set

# U-Boot
UBOOT_CONFIG=hc1706h-agt706-11_defconfig

# Rootfs
ROOTFS_LOADADDR=0x01100000

# DTS
DTB_NAME=hc1706h-agt706-11.dtb

# Pintctrl static setting
PINCTRL_HEADER=hc1706h-agt706-11.h

# DRAM configuration
CONFIG_DDR_TYPE_DDR2=y
# CONFIG_DDR_TYPE_DDR3 is not set
CONFIG_DRAM_CAPACITY=64

CONFIG_DRAM_GENERIC_DDR2=y
# CONFIG_DRAM_GENERIC_DDR3L is not set

# DRAM frequency
# CONFIG_DRAM_MTS_1700 is not set
#CONFIG_DRAM_MTS_1333 is not set
CONFIG_DRAM_MTS_1200=y

# Thermal protection
#CONFIG_THERMAL_PROTECTION_SUPPORT is not set
#CONFIG_THERMAL_PROTECTION_INFO_FROM_ADC is not set
#CONFIG_THERMAL_PROTECTION_ADC_CHANNEL is not set
#CONFIG_THERMAL_PROTECTION_ADC_FORMULA_MULTIPLE is not set
#CONFIG_THERMAL_PROTECTION_ADC_FORMULA_DIVIDE is not set
#CONFIG_THERMAL_PROTECTION_ADC_FORMULA_OFFSET is not set
#CONFIG_THERMAL_PROTECTION_INFO_FROM_SENSOR is not set
#CONFIG_THERMAL_PROTECTION_I2C_CHIP is not set
#CONFIG_THERMAL_PROTECTION_I2C_DEV is not set
#CONFIG_THERMAL_PROTECTION_IIR_COEFFICIENT is not set
#CONFIG_THERMAL_PROTECTION_THRESHOLD_MEDIUM is not set
#CONFIG_THERMAL_PROTECTION_THRESHOLD_HIGH is not set
#CONFIG_THERMAL_PROTECTION_SAMPLE_RATE_MS is not set

# FLASH TYPE
CONFIG_FLASH_NOR=y
#CONFIG_FLASH_NAND is not set

# NAND-specific UBI/UBIFS settings
CONFIG_UBI_PEBSIZE=0x20000
CONFIG_UBI_SUBSIZE=0
CONFIG_UBIFS_LEBSIZE=0x1f000
CONFIG_UBIFS_MINIOSIZE=0x800
CONFIG_ROOTFS_SQUASHFS=y
# Squashfs over UBI is required for NAND products using Squashfs
# CONFIG_ROOTFS_SQUASHFS_OVER_UBI is not set
CONFIG_ROOTFS_SQUASHFS_XZ=y
CONFIG_USRDATA_JFFS2=y
CONFIG_USRDATA_UBIFS_MAXLEBCNT=850
CONFIG_USRDATA_UBIFS_JRNLSIZE=0xC0000
CONFIG_CALIB_UBIFS_MAXLEBCNT=32
CONFIG_CALIB_UBIFS_JRNLSIZE=0x73a0

# Fast boot
CONFIG_FASTBOOT=y
```

## bsp/firmware/build/rule.make/product/hc1706k-agt706-7_defconfig
```kconfig
#CONFIG_HC1702_1752_1772_1782 is not set
#CONFIG_HC1703_1723_1753_1783S is not set
CONFIG_SAPPORO=y
#CONFIG_DUAL_OS is not set
CONFIG_UCLIBC=y

CONFIG_CHIP=HC1706K
CONFIG_MACH=hc1706k-agt706-7
CONFIG_PROD_AGT706_7=y
CONFIG_TARGET_CPU=cortex-a7
CONFIG_NVSP_LAYOUT="hc1706k-agt706-7.ini"
SENSOR=JXF37P
SENSOR1=
LENS=JX6409(2MP)+CUT
MOTHERBOARD=MB035
AUDIO_CODEC=adc


# Buildroot
BUILDROOT_DEFCONFIG=arm-augentix-linux-uclibcgnueabihf_gstreamer_defconfig

# Applications
APP_CONFIG=hc1706k-agt706-7_defconfig

# Sample demo
SAMPLE_DEMO_CONFIG=hc1706k-agt706-7_defconfig

# Sample tee demo
SAMPLE_OPTEE_CONFIG=hc1706k-agt706-7_defconfig

# Remote
REMOTE_CONFIG=hc1706k-agt706-7_defconfig

# AMPC
AMPC_CONFIG=hc1706k-agt706-7_defconfig

# Kernel
KERNEL_CONFIG=hc1706k-agt706-7_defconfig
CONFIG_KERNEL_V6_1=y
CONFIG_UIMAGE_LOADADDR=0x01000000
# uimage compression support none, gzip, bzip2, lzma, lzo, lz4
CONFIG_UIMAGE_COMPRESS=none
#CONFIG_UIMAGE_DECOMPRESS_ADDR=0x00200000

# TEE
CONFIG_OPTEE=y
OPTEE_CONFIG=hc1706k-agt706-7_defconfig
CONFIG_SYS_MEM_TOP_HIDE=0x170000
CONFIG_PROTECTED_BLOCK_NUM=4
CONFIG_NUMBER_OF_CNTS=10
CONFIG_PT_NUM_MONO_CNT=6

# Audio
#CONFIG_AUDIO_DMIC_READY_DELAY is not set

# U-Boot
UBOOT_CONFIG=hc1706k-agt706-7_defconfig

# Rootfs
ROOTFS_LOADADDR=0x01100000

# DTS
DTB_NAME=hc1706k-agt706-7.dtb

# Pintctrl static setting
PINCTRL_HEADER=hc1706k-agt706-7.h

# DRAM configuration
CONFIG_DDR_TYPE_DDR2=y
# CONFIG_DDR_TYPE_DDR3 is not set
CONFIG_DRAM_CAPACITY=64

CONFIG_DRAM_GENERIC_DDR2=y
# CONFIG_DRAM_GENERIC_DDR3L is not set

# DRAM frequency
# CONFIG_DRAM_MTS_1700 is not set
#CONFIG_DRAM_MTS_1333 is not set
CONFIG_DRAM_MTS_1200=y

# Thermal protection
#CONFIG_THERMAL_PROTECTION_SUPPORT is not set
#CONFIG_THERMAL_PROTECTION_INFO_FROM_ADC is not set
#CONFIG_THERMAL_PROTECTION_ADC_CHANNEL is not set
#CONFIG_THERMAL_PROTECTION_ADC_FORMULA_MULTIPLE is not set
#CONFIG_THERMAL_PROTECTION_ADC_FORMULA_DIVIDE is not set
#CONFIG_THERMAL_PROTECTION_ADC_FORMULA_OFFSET is not set
#CONFIG_THERMAL_PROTECTION_INFO_FROM_SENSOR is not set
#CONFIG_THERMAL_PROTECTION_I2C_CHIP is not set
#CONFIG_THERMAL_PROTECTION_I2C_DEV is not set
#CONFIG_THERMAL_PROTECTION_IIR_COEFFICIENT is not set
#CONFIG_THERMAL_PROTECTION_THRESHOLD_MEDIUM is not set
#CONFIG_THERMAL_PROTECTION_THRESHOLD_HIGH is not set
#CONFIG_THERMAL_PROTECTION_SAMPLE_RATE_MS is not set

# FLASH TYPE
CONFIG_FLASH_NOR=y
#CONFIG_FLASH_NAND is not set

# NAND-specific UBI/UBIFS settings
CONFIG_UBI_PEBSIZE=0x20000
CONFIG_UBI_SUBSIZE=0
CONFIG_UBIFS_LEBSIZE=0x1f000
CONFIG_UBIFS_MINIOSIZE=0x800
CONFIG_ROOTFS_SQUASHFS=y
# Squashfs over UBI is required for NAND products using Squashfs
# CONFIG_ROOTFS_SQUASHFS_OVER_UBI is not set
CONFIG_ROOTFS_SQUASHFS_XZ=y
CONFIG_USRDATA_JFFS2=y
CONFIG_USRDATA_UBIFS_MAXLEBCNT=850
CONFIG_USRDATA_UBIFS_JRNLSIZE=0xC0000
CONFIG_CALIB_UBIFS_MAXLEBCNT=32
CONFIG_CALIB_UBIFS_JRNLSIZE=0x73a0

# Secure Boot
CONFIG_SECURE_BOOT=y
CONFIG_DM_INIT=y
#CONFIG_CUSTOM_SIGN is not set
#CUSTOM_SPL_KEY is not set
#CUSTOM_UBOOT_KEY is not set
#CUSTOM_FITIMG_KEY is not set
#CUSTOM_SYSUPD_KEY is not set
#CUSTOM_APP_KEY is not set
#CUSTOM_APPUPD_KEY is not set
#CUSTOM_OPTEE_TA_KEY is not set
```

## bsp/firmware/build/rule.make/product/hc1726-agt726-2_defconfig
```kconfig
#CONFIG_HC1702_1752_1772_1782 is not set
#CONFIG_HC1703_1723_1753_1783S is not set
CONFIG_SAPPORO=y
#CONFIG_DUAL_OS is not set
CONFIG_UCLIBC=y

CONFIG_CHIP=HC1726
CONFIG_MACH=hc1726-agt726-2
CONFIG_PROD_AGT726_2=y
CONFIG_TARGET_CPU=cortex-a7
CONFIG_NVSP_LAYOUT="hc1726-agt726-2.ini"
SENSOR=GC2083
SENSOR1=SC301IOT
LENS=YT10046(2MP)+H59+IR0146_CPSID99155
LENS1=YT0W4F21-5MP+H59+IR0146_CPSID99157
MOTHERBOARD=TB013
AUDIO_CODEC=adc


# Buildroot
BUILDROOT_DEFCONFIG=arm-augentix-linux-uclibcgnueabihf_gstreamer_defconfig

# Applications
APP_CONFIG=hc1726-agt726-2_defconfig

# Sample demo
SAMPLE_DEMO_CONFIG=hc1726-agt726-2_defconfig

# Sample tee demo
SAMPLE_OPTEE_CONFIG=hc1726-agt726-2_defconfig

# Remote
REMOTE_CONFIG=hc1726-agt726-2_defconfig

# AMPC
AMPC_CONFIG=hc1726-agt726-2_defconfig

# Kernel
KERNEL_CONFIG=hc1726-agt726-2_defconfig
CONFIG_KERNEL_V6_1=y
CONFIG_UIMAGE_LOADADDR=0x01000000
# uimage compression support none, gzip, bzip2, lzma, lzo, lz4
CONFIG_UIMAGE_COMPRESS=none
#CONFIG_UIMAGE_DECOMPRESS_ADDR=0x00200000

# TEE
OPTEE_CONFIG=hc1726-agt726-2_defconfig

# Audio
#CONFIG_AUDIO_DMIC_READY_DELAY is not set

# U-Boot
UBOOT_CONFIG=hc1726-agt726-2_defconfig

# Rootfs
ROOTFS_LOADADDR=0x01100000

# DTS
DTB_NAME=hc1726-agt726-2.dtb

# Pintctrl static setting
PINCTRL_HEADER=hc1726-agt726-2.h

# DRAM configuration
# CONFIG_DDR_TYPE_DDR2 is not set
CONFIG_DDR_TYPE_DDR3=y
CONFIG_DRAM_CAPACITY=128

# CONFIG_DRAM_GENERIC_DDR2 is not set
CONFIG_DRAM_GENERIC_DDR3L=y

# DRAM frequency
# CONFIG_DRAM_MTS_1600 is not set
CONFIG_DRAM_MTS_1333=y

# Thermal protection
#CONFIG_THERMAL_PROTECTION_SUPPORT is not set
#CONFIG_THERMAL_PROTECTION_INFO_FROM_ADC is not set
#CONFIG_THERMAL_PROTECTION_ADC_CHANNEL is not set
#CONFIG_THERMAL_PROTECTION_ADC_FORMULA_MULTIPLE is not set
#CONFIG_THERMAL_PROTECTION_ADC_FORMULA_DIVIDE is not set
#CONFIG_THERMAL_PROTECTION_ADC_FORMULA_OFFSET is not set
#CONFIG_THERMAL_PROTECTION_INFO_FROM_SENSOR is not set
#CONFIG_THERMAL_PROTECTION_I2C_CHIP is not set
#CONFIG_THERMAL_PROTECTION_I2C_DEV is not set
#CONFIG_THERMAL_PROTECTION_IIR_COEFFICIENT is not set
#CONFIG_THERMAL_PROTECTION_THRESHOLD_MEDIUM is not set
#CONFIG_THERMAL_PROTECTION_THRESHOLD_HIGH is not set
#CONFIG_THERMAL_PROTECTION_SAMPLE_RATE_MS is not set

# FLASH TYPE
#CONFIG_FLASH_NOR is not set
#CONFIG_FLASH_NAND is not set
CONFIG_EMMC=y

CONFIG_ROOTFS_SQUASHFS=y
# CONFIG_ROOTFS_SQUASHFS_XZ
CONFIG_USRDATAFS_EXT4=y
CONFIG_USRDATAFS_EXT4_BLKSIZE=1024
CONFIG_USRDATAFS_EXT4_BLKCNT=2050
CONFIG_CALIBFS_EXT4=y
CONFIG_CALIBFS_EXT4_BLKSIZE=1024
CONFIG_CALIBFS_EXT4_BLKCNT=2050

# Fast boot
CONFIG_FASTBOOT=y
CONFIG_INITRAMFS=y
```

## bsp/firmware/build/rule.make/product/hc1726-dfn202-113002_defconfig
```kconfig
#CONFIG_HC1702_1752_1772_1782 is not set
#CONFIG_HC1703_1723_1753_1783S is not set
CONFIG_SAPPORO=y
#CONFIG_DUAL_OS is not set
CONFIG_UCLIBC=y

CONFIG_CHIP=HC1726
CONFIG_MACH=hc1726-dfn202-113002
CONFIG_PROD_DFN202_113002=y
CONFIG_TARGET_CPU=cortex-a7
CONFIG_NVSP_LAYOUT="hc1726-dfn202-113002.ini"
SENSOR=SC2336
SENSOR1=SC2336
LENS=JX6409(2MP)+CUT_CPSID3844
LENS1=JX6409(2MP)+CUT_CPSID3844
MOTHERBOARD=TB012
AUDIO_CODEC=adc


# Buildroot
BUILDROOT_DEFCONFIG=arm-augentix-linux-uclibcgnueabihf_gstreamer_defconfig

# Applications
APP_CONFIG=hc1726-dfn202-113002_defconfig

# Sample demo
SAMPLE_DEMO_CONFIG=hc1726-dfn202-113002_defconfig

# Sample tee demo
SAMPLE_OPTEE_CONFIG=hc1726-dfn202-113002_defconfig

# Remote
REMOTE_CONFIG=hc1726-dfn202-113002_defconfig

# AMPC
AMPC_CONFIG=hc1726-dfn202-113002_defconfig

# Kernel
KERNEL_CONFIG=hc1726-dfn202-113002_defconfig
CONFIG_KERNEL_V6_1=y
CONFIG_UIMAGE_LOADADDR=0x01000000

# TEE
CONFIG_OPTEE=y
OPTEE_CONFIG=hc1726-dfn202-113002_defconfig
CONFIG_SYS_MEM_TOP_HIDE=0x170000
CONFIG_PROTECTED_BLOCK_NUM=4
CONFIG_NUMBER_OF_CNTS=10
CONFIG_PT_NUM_MONO_CNT=11


# Audio
#CONFIG_AUDIO_DMIC_READY_DELAY is not set

# U-Boot
UBOOT_CONFIG=hc1726-dfn202-113002_defconfig

# Rootfs
ROOTFS_LOADADDR=0x01100000

# DTS
DTB_NAME=hc1726-dfn202-113002.dtb

# Pintctrl static setting
PINCTRL_HEADER=hc1726-dfn202-113002.h

# DRAM configuration
# CONFIG_DDR_TYPE_DDR2 is not set
CONFIG_DDR_TYPE_DDR3=y
CONFIG_DRAM_CAPACITY=128

# CONFIG_DRAM_GENERIC_DDR2 is not set
CONFIG_DRAM_GENERIC_DDR3L=y

# DRAM frequency
# CONFIG_DRAM_MTS_1600 is not set
CONFIG_DRAM_MTS_1333=y

# Thermal protection
#CONFIG_THERMAL_PROTECTION_SUPPORT is not set
#CONFIG_THERMAL_PROTECTION_INFO_FROM_ADC is not set
#CONFIG_THERMAL_PROTECTION_ADC_CHANNEL is not set
#CONFIG_THERMAL_PROTECTION_ADC_FORMULA_MULTIPLE is not set
#CONFIG_THERMAL_PROTECTION_ADC_FORMULA_DIVIDE is not set
#CONFIG_THERMAL_PROTECTION_ADC_FORMULA_OFFSET is not set
#CONFIG_THERMAL_PROTECTION_INFO_FROM_SENSOR is not set
#CONFIG_THERMAL_PROTECTION_I2C_CHIP is not set
#CONFIG_THERMAL_PROTECTION_I2C_DEV is not set
#CONFIG_THERMAL_PROTECTION_IIR_COEFFICIENT is not set
#CONFIG_THERMAL_PROTECTION_THRESHOLD_MEDIUM is not set
#CONFIG_THERMAL_PROTECTION_THRESHOLD_HIGH is not set
#CONFIG_THERMAL_PROTECTION_SAMPLE_RATE_MS is not set

# FLASH TYPE
#CONFIG_FLASH_NOR is not set
CONFIG_FLASH_NAND=y

# Rootfs initramfs setting
# NAND-specific UBI/UBIFS settings
CONFIG_UBI_PEBSIZE=0x20000
CONFIG_UBI_SUBSIZE=0
CONFIG_UBIFS_LEBSIZE=0x1f000
CONFIG_UBIFS_MINIOSIZE=0x800
CONFIG_ROOTFS_SQUASHFS=y
# Squashfs over UBI is required for NAND products using Squashfs
CONFIG_ROOTFS_SQUASHFS_OVER_UBI=y
CONFIG_ROOTFS_SQUASHFS_XZ=y
#CONFIG_ROOTFS_UBIFS is not set
CONFIG_ROOTFS_UBIFS_VOL_SIZE_MB=52
CONFIG_ROOTFS_UBIFS_MAXLEBCNT=460
CONFIG_ROOTFS_UBIFS_JRNLSIZE=0x5d000
#CONFIG_USRDATA_JFFS2 is not set
CONFIG_USRDATA_UBIFS_MAXLEBCNT=850
CONFIG_USRDATA_UBIFS_JRNLSIZE=0xC0000
CONFIG_CALIB_UBIFS_MAXLEBCNT=32
CONFIG_CALIB_UBIFS_JRNLSIZE=0x73a0

# Fastboot
# !!! It is a MUST to disable CONFIG_FASTBOOT when using Fastboot without early video/audio;
# !!! otherwise, it will run into the wrong boot flow.
#CONFIG_FASTBOOT is not set
# !!! This conflicts with CONFIG_DM_INIT.
CONFIG_INITRAMFS=y
CONFIG_INITRAMFS_MPI_STREAM=y

# Secure Boot
CONFIG_SECURE_BOOT=y
#CONFIG_DM_INIT is not set
#CONFIG_CUSTOM_SIGN is not set
#CUSTOM_SPL_KEY is not set
#CUSTOM_UBOOT_KEY is not set
#CUSTOM_FITIMG_KEY is not set
#CUSTOM_SYSUPD_KEY is not set
#CUSTOM_APP_KEY is not set
#CUSTOM_APPUPD_KEY is not set
#CUSTOM_OPTEE_TA_KEY is not set
```
