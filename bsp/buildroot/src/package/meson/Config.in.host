## bsp/firmware/build/rule.make/product/hc1726-str726-13_defconfig
```kconfig
#CONFIG_HC1702_1752_1772_1782 is not set
#CONFIG_HC1703_1723_1753_1783S is not set
CONFIG_SAPPORO=y
#CONFIG_DUAL_OS is not set
CONFIG_UCLIBC=y

CONFIG_CHIP=HC1726
CONFIG_MACH=hc1726-str726-13
CONFIG_PROD_STR726_13=y
CONFIG_TARGET_CPU=cortex-a7
CONFIG_NVSP_LAYOUT="hc1726-str726-13.ini"
SENSOR=JXQ03P
SENSOR1=
LENS=YT12002-3MP+IR0780_CPSID112927
LENS1=
MOTHERBOARD=MB001_3S
AUDIO_CODEC=adc

CASE_CONFIG=case_config_str726-13_h264x2_1080p15_720p30
CASE_CONFIG+=ircut.sh

# Buildroot
BUILDROOT_DEFCONFIG=arm-augentix-linux-uclibcgnueabihf_gstreamer_defconfig

# Applications
APP_CONFIG=hc1726-str726-13_defconfig

# Sample demo
SAMPLE_DEMO_CONFIG=hc1726-str726-13_defconfig

# Sample tee demo
SAMPLE_OPTEE_CONFIG=hc1726-str726-13_defconfig

# Remote
REMOTE_CONFIG=hc1726-str726-13_defconfig

# AMPC
AMPC_CONFIG=hc1726-str726-13_defconfig

# Kernel
KERNEL_CONFIG=hc1726-str726-13_defconfig
CONFIG_KERNEL_V6_1=y
CONFIG_UIMAGE_LOADADDR=0x01000000

# TEE
CONFIG_OPTEE=y
OPTEE_CONFIG=hc1726-str726-13_defconfig
CONFIG_SYS_MEM_TOP_HIDE=0x170000
CONFIG_PROTECTED_BLOCK_NUM=4
CONFIG_NUMBER_OF_CNTS=10
CONFIG_PT_NUM_MONO_CNT=11

# Audio
#CONFIG_AUDIO_DMIC_READY_DELAY is not set

# U-Boot
UBOOT_CONFIG=hc1726-str726-13_defconfig

# Rootfs
ROOTFS_LOADADDR=0x01100000

# DTS
DTB_NAME=hc1726-str726-13.dtb

# Pintctrl static setting
PINCTRL_HEADER=hc1726-str726-13.h

# CPU
CONFIG_CPU_LOW_SPEED=y

# DRAM configuration
# CONFIG_DDR_TYPE_DDR2 is not set
CONFIG_DDR_TYPE_DDR3=y

# CONFIG_DRAM_GENERIC_DDR2 is not set
CONFIG_DRAM_GENERIC_DDR3L=y

CONFIG_DRAM_CAPACITY=128

# DRAM frequency
CONFIG_DRAM_MTS_1066=y
# CONFIG_DRAM_MTS_1033 is not set

# Thermal protection
#CONFIG_THERMAL_PROTECTION_SUPPORT is not set
#CONFIG_THERMAL_PROTECTION_INFO_FROM_ADC is not set
#CONFIG_THERMAL_PROTECTION_ADC_CHANNEL is not set
#CONFIG_THERMAL_PROTECTION_ADC_FORMULA_MULTIPLE is not set
#CONFIG_THERMAL_PROTECTION_ADC_FORMULA_DIVIDE is not set
#CONFIG_THERMAL_PROTECTION_ADC_FORMULA_OFFSET is not set
#CONFIG_THERMAL_PROTECTION_INFO_FROM_SENSOR is not set
#CONFIG_THERMAL_PROTECTION_I2C_CHIP is not set
#CONFIG_THERMAL_PROTECTION_I2C_DEV is not set
#CONFIG_THERMAL_PROTECTION_IIR_COEFFICIENT is not set
#CONFIG_THERMAL_PROTECTION_THRESHOLD_MEDIUM is not set
#CONFIG_THERMAL_PROTECTION_THRESHOLD_HIGH is not set
#CONFIG_THERMAL_PROTECTION_SAMPLE_RATE_MS is not set

# FLASH TYPE
#CONFIG_FLASH_NOR is not set
CONFIG_FLASH_NAND=y

# Rootfs initramfs setting
# NAND-specific UBI/UBIFS settings
CONFIG_UBI_PEBSIZE=0x20000
CONFIG_UBI_SUBSIZE=0
CONFIG_UBIFS_LEBSIZE=0x1f000
CONFIG_UBIFS_MINIOSIZE=0x800
CONFIG_ROOTFS_SQUASHFS=y
# Squashfs over UBI is required for NAND products using Squashfs
CONFIG_ROOTFS_SQUASHFS_OVER_UBI=y
CONFIG_ROOTFS_SQUASHFS_XZ=y
#CONFIG_ROOTFS_UBIFS is not set
CONFIG_ROOTFS_UBIFS_VOL_SIZE_MB=52
CONFIG_ROOTFS_UBIFS_MAXLEBCNT=460
CONFIG_ROOTFS_UBIFS_JRNLSIZE=0x5d000
#CONFIG_USRDATA_JFFS2 is not set
CONFIG_USRDATA_UBIFS_MAXLEBCNT=850
CONFIG_USRDATA_UBIFS_JRNLSIZE=0xC0000
CONFIG_CALIB_UBIFS_MAXLEBCNT=32
CONFIG_CALIB_UBIFS_JRNLSIZE=0x73a0

# Secure Boot
CONFIG_SECURE_BOOT=y
CONFIG_DM_INIT=y
#CONFIG_CUSTOM_SIGN is not set
#CUSTOM_SPL_KEY is not set
#CUSTOM_UBOOT_KEY is not set
#CUSTOM_FITIMG_KEY is not set
#CUSTOM_SYSUPD_KEY is not set
#CUSTOM_APP_KEY is not set
#CUSTOM_APPUPD_KEY is not set
#CUSTOM_OPTEE_TA_KEY is not set
```

## bsp/firmware/build/rule.make/product/hc1726-tb012-smp_defconfig
```kconfig
#CONFIG_HC1702_1752_1772_1782 is not set
#CONFIG_HC1703_1723_1753_1783S is not set
CONFIG_SAPPORO=y
#CONFIG_DUAL_OS is not set
CONFIG_UCLIBC=y

CONFIG_CHIP=HC1726
CONFIG_MACH=hc1726-tb012-slt
CONFIG_PROD_AGT706_1=y
CONFIG_TARGET_CPU=cortex-a7
CONFIG_NVSP_LAYOUT="hc1726-tb012-slt.ini"
SENSOR=GC2083
SENSOR1=GC2083
LENS=JX6409(2MP)+CUT
MOTHERBOARD=TB012
AUDIO_CODEC=adc


# Buildroot
BUILDROOT_DEFCONFIG=arm-augentix-linux-uclibcgnueabihf_defconfig

# Applications
APP_CONFIG=hc1726-tb012-slt_defconfig

# Sample demo
SAMPLE_DEMO_CONFIG=hc1726-tb012-slt_defconfig

# Sample tee demo
SAMPLE_OPTEE_CONFIG=hc1726-tb012-slt_defconfig

# Remote
REMOTE_CONFIG=hc1726-tb012-slt_defconfig

# AMPC
AMPC_CONFIG=hc1726-tb012-slt_defconfig

# Kernel
KERNEL_CONFIG=hc1726-tb012-smp_defconfig
#CONFIG_KERNEL_V6_1=y
CONFIG_UIMAGE_LOADADDR=0x01000000
# uimage compression support none, gzip, bzip2, lzma, lzo, lz4
CONFIG_UIMAGE_COMPRESS=none
#CONFIG_UIMAGE_DECOMPRESS_ADDR=0x00200000

# TEE
OPTEE_CONFIG=hc1726-tb012-slt_defconfig

# Audio
#CONFIG_AUDIO_DMIC_READY_DELAY is not set

# U-Boot
UBOOT_CONFIG=hc1726-tb012-slt_defconfig

# Rootfs
ROOTFS_LOADADDR=0x01100000

# DTS
DTB_NAME=hc1726-tb012-smp.dtb

# Pintctrl static setting
PINCTRL_HEADER=hc1726-tb012-slt.h

# DRAM configuration
# CONFIG_DDR_TYPE_DDR2 is not set
CONFIG_DDR_TYPE_DDR3=y
CONFIG_DRAM_CAPACITY=128

# CONFIG_DRAM_GENERIC_DDR2 is not set
CONFIG_DRAM_GENERIC_DDR3L=y

# DRAM frequency
# CONFIG_DRAM_MTS_1600 is not set
CONFIG_DRAM_MTS_1333=y

# Thermal protection
#CONFIG_THERMAL_PROTECTION_SUPPORT is not set
#CONFIG_THERMAL_PROTECTION_INFO_FROM_ADC is not set
#CONFIG_THERMAL_PROTECTION_ADC_CHANNEL is not set
#CONFIG_THERMAL_PROTECTION_ADC_FORMULA_MULTIPLE is not set
#CONFIG_THERMAL_PROTECTION_ADC_FORMULA_DIVIDE is not set
#CONFIG_THERMAL_PROTECTION_ADC_FORMULA_OFFSET is not set
#CONFIG_THERMAL_PROTECTION_INFO_FROM_SENSOR is not set
#CONFIG_THERMAL_PROTECTION_I2C_CHIP is not set
#CONFIG_THERMAL_PROTECTION_I2C_DEV is not set
#CONFIG_THERMAL_PROTECTION_IIR_COEFFICIENT is not set
#CONFIG_THERMAL_PROTECTION_THRESHOLD_MEDIUM is not set
#CONFIG_THERMAL_PROTECTION_THRESHOLD_HIGH is not set
#CONFIG_THERMAL_PROTECTION_SAMPLE_RATE_MS is not set

# FLASH TYPE
CONFIG_FLASH_NOR=y
#CONFIG_FLASH_NAND is not set

# NAND-specific UBI/UBIFS settings
CONFIG_UBI_PEBSIZE=0x20000
CONFIG_UBI_SUBSIZE=0
CONFIG_UBIFS_LEBSIZE=0x1f000
CONFIG_UBIFS_MINIOSIZE=0x800
CONFIG_ROOTFS_SQUASHFS=y
# Squashfs over UBI is required for NAND products using Squashfs
# CONFIG_ROOTFS_SQUASHFS_OVER_UBI is not set
CONFIG_ROOTFS_SQUASHFS_XZ=y
CONFIG_USRDATA_JFFS2=y
CONFIG_USRDATA_UBIFS_MAXLEBCNT=850
CONFIG_USRDATA_UBIFS_JRNLSIZE=0xC0000
CONFIG_CALIB_UBIFS_MAXLEBCNT=32
CONFIG_CALIB_UBIFS_JRNLSIZE=0x73a0
```

## bsp/firmware/build/rule.make/product/hc1783s-fpu-agt800-42_defconfig
```kconfig
#CONFIG_HC1702_1752_1772_1782 is not set
CONFIG_HC1703_1723_1753_1783S=y
#CONFIG_DUAL_OS is not set

CONFIG_CHIP=HC1783S_FPU
CONFIG_MACH=hc1783s-fpu-agt800-42
CONFIG_PROD_AGT800_42=y
CONFIG_TARGET_CPU=cortex-a7
CONFIG_NVSP_LAYOUT="hc1783s-fpu-agt800-42.ini"
SENSOR=JXK05
SENSOR1=
LENS=YTW10081A01-8MP+H59+IR0117
LENS1=
MOTHERBOARD=TB006
AUDIO_CODEC=adc

# Buildroot
BUILDROOT_DEFCONFIG=arm-linux-gnueabihf_defconfig

# Applications
APP_CONFIG=hc1783s-fpu-agt800-42_defconfig

# Sample demo
SAMPLE_DEMO_CONFIG=hc1783s-fpu-agt800-42_defconfig

# Sample tee demo
SAMPLE_OPTEE_CONFIG=hc1783s-fpu-agt800-42_defconfig

# Remote
REMOTE_CONFIG=hc1783s-fpu-agt800-42_defconfig

# AMPC
AMPC_CONFIG=hc1783s-fpu-agt800-42_defconfig

# Kernel
KERNEL_CONFIG=hc1783s-fpu-agt800-42_defconfig
CONFIG_UIMAGE_LOADADDR=0x01000000
# uimage compression support none, gzip, bzip2, lzma, lzo, lz4
CONFIG_UIMAGE_COMPRESS=none
#CONFIG_UIMAGE_DECOMPRESS_ADDR=0x00200000

# TEE
OPTEE_CONFIG=hc1783s-fpu-agt800-42_defconfig

# Audio
#CONFIG_AUDIO_DMIC_READY_DELAY is not set

# U-Boot
UBOOT_CONFIG=hc1783s-fpu-agt800-42_defconfig

# Rootfs
ROOTFS_LOADADDR=0x01100000

# DTS
DTB_NAME=hc1783s-fpu-agt800-42.dtb

# Pintctrl static setting
PINCTRL_HEADER=hc1783s-fpu-agt800-42.h

# DRAM configuration
#CONFIG_DDR_TYPE_DDR2 is not set
CONFIG_DDR_TYPE_DDR3=y
CONFIG_DRAM_CAPACITY=512

#CONFIG_DRAM_GENERIC_DDR2 is not set
CONFIG_DRAM_GENERIC_DDR3L=y

# DRAM frequency
CONFIG_DRAM_MTS_1700=y
#CONFIG_DRAM_MTS_1600 is not set

# Thermal protection
#CONFIG_THERMAL_PROTECTION_SUPPORT is not set
#CONFIG_THERMAL_PROTECTION_INFO_FROM_ADC is not set
#CONFIG_THERMAL_PROTECTION_ADC_CHANNEL is not set
#CONFIG_THERMAL_PROTECTION_ADC_FORMULA_MULTIPLE is not set
#CONFIG_THERMAL_PROTECTION_ADC_FORMULA_DIVIDE is not set
#CONFIG_THERMAL_PROTECTION_ADC_FORMULA_OFFSET is not set
#CONFIG_THERMAL_PROTECTION_INFO_FROM_SENSOR is not set
#CONFIG_THERMAL_PROTECTION_I2C_CHIP is not set
#CONFIG_THERMAL_PROTECTION_I2C_DEV is not set
#CONFIG_THERMAL_PROTECTION_IIR_COEFFICIENT is not set
#CONFIG_THERMAL_PROTECTION_THRESHOLD_MEDIUM is not set
#CONFIG_THERMAL_PROTECTION_THRESHOLD_HIGH is not set
#CONFIG_THERMAL_PROTECTION_SAMPLE_RATE_MS is not set

# FLASH TYPE
#CONFIG_FLASH_NOR is not set
CONFIG_FLASH_NAND=y

# Rootfs initramfs setting
# NAND-specific UBI/UBIFS settings
CONFIG_UBI_PEBSIZE=0x20000
CONFIG_UBI_SUBSIZE=0
CONFIG_UBIFS_LEBSIZE=0x1f000
CONFIG_UBIFS_MINIOSIZE=0x800
CONFIG_ROOTFS_SQUASHFS=y
# Squashfs over UBI is required for NAND products using Squashfs
CONFIG_ROOTFS_SQUASHFS_OVER_UBI=y
CONFIG_ROOTFS_SQUASHFS_XZ=y
# CONFIG_ROOTFS_UBIFS is not set
CONFIG_ROOTFS_UBIFS_VOL_SIZE_MB=52
CONFIG_ROOTFS_UBIFS_MAXLEBCNT=460
CONFIG_ROOTFS_UBIFS_JRNLSIZE=0x5d000
#CONFIG_USRDATA_JFFS2 is not set
CONFIG_USRDATA_UBIFS_MAXLEBCNT=850
CONFIG_USRDATA_UBIFS_JRNLSIZE=0xC0000
CONFIG_CALIB_UBIFS_MAXLEBCNT=32
CONFIG_CALIB_UBIFS_JRNLSIZE=0x73a0

# Secure Boot
CONFIG_SECURE_BOOT=y
#CONFIG_CUSTOM_SIGN is not set
#CUSTOM_SPL_KEY is not set
#CUSTOM_UBOOT_KEY is not set
#CUSTOM_FITIMG_KEY is not set
#CUSTOM_SYSUPD_KEY is not set
#CUSTOM_APP_KEY is not set
#CUSTOM_APPUPD_KEY is not set
#CUSTOM_OPTEE_TA_KEY is not set
CONFIG_INITRAMFS=y
```

## bsp/firmware/reference_software/3rd_party/Kconfig
```kconfig
menu "3rd_party"

config APP_TUYA_SERVICE
	bool "tuya_service"

config APP_TUYA_IPC_SDK_PATH
	string "Tuya IPC SDK path"
	default "/path/to/tuya_ipc_sdk"
	depends on APP_TUYA_SERVICE
	help
	  Path to where the Tuya IPC SDK is installed.

config APP_TUTK_SERVICE
	bool "tutk_service"
	default n
	select LIBTZ
	select LIBLPW
	select APP_SNTP
	help
		TUTK service base on TUTK SDK version 4.3.22

config APP_TUTK_SDK_PATH
	string "TUTK SDK path"
	default "/path/to/tutk_sdk"
	depends on APP_TUTK_SERVICE
	help
	  Path to where the TUTK SDK is installed.

config APP_TANGE_CLOUD
	bool "tange cloud"
	default n

choice APP_TANGE_CLOUD_SWITCH_VIDEO_APP
	bool "select a video application"
	depends on APP_TANGE_CLOUD

config TANGE_USE_AV_MAIN2
	bool "tange use av_main2"
	help
		help_av_main2

config TANGE_USE_AGT_MPI_STREAM
	bool "tange use mpi_stream"
	help
		help_mpi_stream

endchoice

config APP_AMAZON_KVS
	bool "Amazon KVS"
	default n
	help
		Amazon Kinesis Video Streams with WebRTC

config APP_SECURE_ELEMENT
	bool "Secure_element"
	default n
	help
		Use secure element feature and install library file.

config APP_SECURE_ELEMENT_DEMO
	depends on APP_SECURE_ELEMENT
	bool "secure_element_demo"
	default n
	help
		Example program demonstrating the use of a Secure Element through the I2C interface.

choice
	depends on APP_SECURE_ELEMENT_DEMO
	prompt "Select the Secure Element"
	default SE_SQ7131

config SE_SQ7131
	depends on APP_SECURE_ELEMENT_DEMO
	bool "SQ7131"

config SE_SQ7131S
	depends on APP_SECURE_ELEMENT_DEMO
	bool "SQ7131S"

endchoice

config APP_SE_TRNG_PROVIDER
	depends on APP_SECURE_ELEMENT
	bool "Custom RNG Provider using Secure Element"
	default n
	help
		Enable a custom RNG provider for OpenSSL v3.x that integrates the 
		True Random Number Generator (TRNG) functionality provided by the Secure Element. 
		This provider relies on Secure Element hardware and the libse core library for RNG operations.
		
		Note: Ensure that the Secure Element hardware and libse core library are properly configured and available in your environment.

endmenu
```

## bsp/firmware/reference_software/Kconfig
```kconfig
mainmenu "Augentix SDK Application Configuration"

source "library/Kconfig"
source "3rd_party/Kconfig"
source "apps/Kconfig"
source "database/Kconfig"
source "utils/Kconfig"
source "web/Kconfig"
```

## bsp/firmware/reference_software/apps/Kconfig
```kconfig
menu "apps"

source "apps/av_daemon/Kconfig"

config APP_AIC8800_M40
	bool "aic8800_m40"
	default n

config APP_CONNSEL
	bool "connsel"
	default y

config APP_EAIF_SERVER
	bool "eaif_server"
	depends on APP_AV_MAIN2
	default n

config APP_IP_ASSIGN
	bool "ip_assign"
	default y

config APP_STAMEN
	bool "stamen"
	default y

config APP_WIFI
	bool "wifi"
	default y

config APP_FLV_SERVER
	bool "flv_server"
	default y

config APP_SUPPORT_HTTPS
	bool "support https"
	default y
	depends on APP_FLV_SERVER

config APP_WEBSOCKET_AUDIO_PLAYBACK
	bool "support audio playback based on websocket"
	default y
	depends on APP_SUPPORT_HTTPS

config APP_MP4_RECORDER
	bool "mp4_recorder"
	default n
	help
		Sample program to demonstrate how to do mp4 recording.
		The sample code depends on the bento4 module, which must be enabled in buildroot.

config APP_EXIF_SNAPSHOT
	bool "exif_snapshot"
	default n
	help
		Reference application for capturing MJPEG snapshots with EXIF metadata.
		This application demonstrates how to capture MJPEG frames and add EXIF
		information including GPS coordinates, timestamps, and camera information.

config APP_GST_RTSP_SERVER
	bool "gst_rtsp_server"
	default n
	help
		Gstreamer RTSP server

config APP_GST_RTSP_SERVER_ENABLE_IVA
	bool "GST RTSP Server enable IVA"
	select LIBAVFTR
	depends on APP_GST_RTSP_SERVER
	default y
	help
		When the option is enabled, gstreamer rtsp server use libavftr API to get vaftr shm to generate SEI.

endmenu
```

## bsp/firmware/reference_software/library/Kconfig
```kconfig
menu "library"

config LIBFOO
	bool "libfoo"
	default n
	help
	  Reference library.

config LIBGPIO
	bool "libgpio"
	default n

config LIBPWM
	bool "libpwm"
	default n

config LIBSQL
	bool "libsql"
	default n

config LIBTZ
	bool "libtz"
	default n

config LIBUTILS
	bool "libutils"
	default y

endmenu
```

## bsp/firmware/reference_software/utils/sysupd_tools/Kconfig
```kconfig
choice
	prompt "Select sysupd tools type"
	default APP_SYSUPD_NORMAL_TOOL

config APP_SYSUPD_NORMAL_TOOL
	bool "normal"

config APP_SYSUPD_ANTI_ROLLBACK_SE_TOOL
	bool "anti_rollback_se"

config APP_SYSUPD_ANTI_ROLLBACK_TEE_TOOL
	bool "anti_rollback_tee"

endchoice
```

## bsp/firmware/reference_software/web/Kconfig
```kconfig
menu "web"

config APP_WEBCGI
	bool "webcgi"
	depends on APP_AV_MAIN2 && APP_CENTCTRL
	default y

config APP_SE_AUTH
	depends on APP_WEBCGI
	bool "se_auth"
	help
		use secure element to encrypt and store username and password
	default n

config APP_TEE_AUTH
	depends on APP_WEBCGI
	bool "tee_auth"
	help
		use TEE to encrypt and store username and password
	default n

config SECURE_WEB_PAGE
	bool "secure web page"
	depends on APP_WEBCGI
	help
		install secure web page assets and configs.
	default n

if APP_WEBCGI

config APP_WEBCGI_DEMO
	bool "Demo apps"
	default n
	help
	  Install demo web apps to the target.

endif

endmenu
```
