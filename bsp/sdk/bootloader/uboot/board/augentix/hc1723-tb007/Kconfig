## bsp/sdk/bootloader/uboot/board/augentix/hc1723-tb007/Kconfig
```kconfig
if TARGET_HC1723_TB007

# board/SYS_VENDOR/SYS_BOARD
config SYS_VENDOR
	default "augentix"
config SYS_BOARD
	default "hc1723-tb007"
# include/config/SYS_CONFIG_NAME.h
config SYS_CONFIG_NAME
	default "hc1723-tb007"

endif

if TARGET_AGT100_22

# board/SYS_VENDOR/SYS_BOARD
config SYS_VENDOR
	default "augentix"
config SYS_BOARD
	default "hc1723-tb007"
# include/config/SYS_CONFIG_NAME.h
config SYS_CONFIG_NAME
	default "hc1723-agt100-22"

endif
```

## bsp/sdk/bootloader/uboot/board/augentix/hc1725-mb023-nor-8mb/Kconfig
```kconfig
if TARGET_HC1725_MB023_NOR_8MB

# board/SYS_VENDOR/SYS_BOARD
config SYS_VENDOR
	default "augentix"
config SYS_BOARD
	default "hc1725-mb023-nor-8mb"
# include/config/SYS_CONFIG_NAME.h
config SYS_CONFIG_NAME
	default "hc1725-mb023-nor-8mb"

endif

if TARGET_HC1725_FPU_MB023_NOR_8MB

# board/SYS_VENDOR/SYS_BOARD
config SYS_VENDOR
	default "augentix"
config SYS_BOARD
	default "hc1725-mb023-nor-8mb"
# include/config/SYS_CONFIG_NAME.h
config SYS_CONFIG_NAME
	default "hc1725-fpu-mb023-nor-8mb"

endif

if TARGET_HC1753_FPU_MB023_NOR_16MB

# board/SYS_VENDOR/SYS_BOARD
config SYS_VENDOR
	default "augentix"
config SYS_BOARD
	default "hc1725-mb023-nor-8mb"
# include/config/SYS_CONFIG_NAME.h
config SYS_CONFIG_NAME
	default "hc1753-fpu-mb023-nor-16mb"

endif
```

## bsp/sdk/bootloader/uboot/board/augentix/hc1725-mb023/Kconfig
```kconfig
if TARGET_AGT300_22

# board/SYS_VENDOR/SYS_BOARD
config SYS_VENDOR
	default "augentix"
config SYS_BOARD
	default "hc1725-mb023"
# include/config/SYS_CONFIG_NAME.h
config SYS_CONFIG_NAME
	default "hc1725-fpu-agt300-22"

endif

if TARGET_AGT725_3

# board/SYS_VENDOR/SYS_BOARD
config SYS_VENDOR
	default "augentix"
config SYS_BOARD
	default "hc1725-mb023"
# include/config/SYS_CONFIG_NAME.h
config SYS_CONFIG_NAME
	default "hc1725-agt725-3"

endif

if TARGET_AGT725_10

# board/SYS_VENDOR/SYS_BOARD
config SYS_VENDOR
	default "augentix"
config SYS_BOARD
	default "hc1725-mb023"
# include/config/SYS_CONFIG_NAME.h
config SYS_CONFIG_NAME
	default "hc1725-agt725-10"

endif

if TARGET_AGT300_23

# board/SYS_VENDOR/SYS_BOARD
config SYS_VENDOR
	default "augentix"
config SYS_BOARD
	default "hc1725-mb023"
# include/config/SYS_CONFIG_NAME.h
config SYS_CONFIG_NAME
	default "hc1725-fpu-agt300-23"

endif
```

## bsp/sdk/bootloader/uboot/board/augentix/hc1725-tb007-slt/Kconfig
```kconfig
if TARGET_HC1725_TB007_SLT

# board/SYS_VENDOR/SYS_BOARD
config SYS_VENDOR
	default "augentix"
config SYS_BOARD
	default "hc1725-tb007-slt"
# include/config/SYS_CONFIG_NAME.h
config SYS_CONFIG_NAME
	default "hc1725-tb007-slt"

endif

if TARGET_HC1725_FPU_TB007_SLT

# board/SYS_VENDOR/SYS_BOARD
config SYS_VENDOR
	default "augentix"
config SYS_BOARD
	default "hc1725-tb007-slt"
# include/config/SYS_CONFIG_NAME.h
config SYS_CONFIG_NAME
	default "hc1725-fpu-tb007-slt"

endif
```

## bsp/sdk/bootloader/uboot/board/augentix/hc1725-tb007/Kconfig
```kconfig
if TARGET_AGT301_20

# board/SYS_VENDOR/SYS_BOARD
config SYS_VENDOR
	default "augentix"
config SYS_BOARD
	default "hc1725-tb007"
# include/config/SYS_CONFIG_NAME.h
config SYS_CONFIG_NAME
	default "hc1725-agt301-20"

endif

if TARGET_AGT100_29

# board/SYS_VENDOR/SYS_BOARD
config SYS_VENDOR
	default "augentix"
config SYS_BOARD
	default "hc1725-tb007"
# include/config/SYS_CONFIG_NAME.h
config SYS_CONFIG_NAME
	default "hc1725-fpu-agt100-29"

endif

if TARGET_AGT100_31

# board/SYS_VENDOR/SYS_BOARD
config SYS_VENDOR
	default "augentix"
config SYS_BOARD
	default "hc1725-tb007"
# include/config/SYS_CONFIG_NAME.h
config SYS_CONFIG_NAME
	default "hc1725-fpu-agt100-31"

endif

if TARGET_AGT725_2

# board/SYS_VENDOR/SYS_BOARD
config SYS_VENDOR
	default "augentix"
config SYS_BOARD
	default "hc1725-tb007"
# include/config/SYS_CONFIG_NAME.h
config SYS_CONFIG_NAME
	default "hc1725-fpu-agt725-2"

endif

if TARGET_AGT725_7

# board/SYS_VENDOR/SYS_BOARD
config SYS_VENDOR
	default "augentix"
config SYS_BOARD
	default "hc1725-tb007"
# include/config/SYS_CONFIG_NAME.h
config SYS_CONFIG_NAME
	default "hc1725-fpu-agt725-7"
endif

if TARGET_AGT725_6

# board/SYS_VENDOR/SYS_BOARD
config SYS_VENDOR
	default "augentix"
config SYS_BOARD
	default "hc1725-tb007"
# include/config/SYS_CONFIG_NAME.h
config SYS_CONFIG_NAME
		default "hc1725-fpu-agt725-6"
endif

if TARGET_AGT725_9

# board/SYS_VENDOR/SYS_BOARD
config SYS_VENDOR
	default "augentix"
config SYS_BOARD
	default "hc1725-tb007"
# include/config/SYS_CONFIG_NAME.h
config SYS_CONFIG_NAME
	default "hc1725-fpu-agt725-9"
endif

if TARGET_AGT725_11

# board/SYS_VENDOR/SYS_BOARD
config SYS_VENDOR
	default "augentix"
config SYS_BOARD
	default "hc1725-tb007"
# include/config/SYS_CONFIG_NAME.h
config SYS_CONFIG_NAME
	default "hc1725-agt725-11"
endif

if TARGET_AGT301_23

# board/SYS_VENDOR/SYS_BOARD
config SYS_VENDOR
	default "augentix"
config SYS_BOARD
	default "hc1725-tb007"
# include/config/SYS_CONFIG_NAME.h
config SYS_CONFIG_NAME
	default "hc1725-agt301-23"

endif
```

## bsp/sdk/bootloader/uboot/board/augentix/hc1725s-tb006-slt/Kconfig
```kconfig
if TARGET_HC1725S_TB006_SLT

# board/SYS_VENDOR/SYS_BOARD
config SYS_VENDOR
	default "augentix"
config SYS_BOARD
	default "hc1725s-tb006-slt"
# include/config/SYS_CONFIG_NAME.h
config SYS_CONFIG_NAME
	default "hc1725s-tb006-slt"

endif
```

## bsp/sdk/bootloader/uboot/board/augentix/hc1726-tb012/Kconfig
```kconfig
if TARGET_HC1726_TB012_SLT

# board/SYS_VENDOR/SYS_BOARD
config SYS_VENDOR
	default "augentix"
config SYS_BOARD
	default "hc1726-tb012"
# include/config/SYS_CONFIG_NAME.h
config SYS_CONFIG_NAME
	default "hc1726-tb012-slt"

endif

if TARGET_AGT726_1

# board/SYS_VENDOR/SYS_BOARD
config SYS_VENDOR
	default "augentix"
config SYS_BOARD
	default "hc1726-tb012"
# include/config/SYS_CONFIG_NAME.h
config SYS_CONFIG_NAME
	default "hc1726-agt726-1"

endif

if TARGET_AGT726_4

# board/SYS_VENDOR/SYS_BOARD
config SYS_VENDOR
	default "augentix"
config SYS_BOARD
	default "hc1726-tb012"
# include/config/SYS_CONFIG_NAME.h
config SYS_CONFIG_NAME
	default "hc1726-agt726-4"

endif

if TARGET_AGT726_3

# board/SYS_VENDOR/SYS_BOARD
config SYS_VENDOR
	default "augentix"
config SYS_BOARD
	default "hc1726-tb012"
# include/config/SYS_CONFIG_NAME.h
config SYS_CONFIG_NAME
	default "hc1726-agt726-3"

endif

if TARGET_AGT726_5

# board/SYS_VENDOR/SYS_BOARD
config SYS_VENDOR
	default "augentix"
config SYS_BOARD
	default "hc1726-tb012"
# include/config/SYS_CONFIG_NAME.h
config SYS_CONFIG_NAME
	default "hc1726-agt726-5"

endif

if TARGET_AGT726_7

# board/SYS_VENDOR/SYS_BOARD
config SYS_VENDOR
	default "augentix"
config SYS_BOARD
	default "hc1726-tb012"
# include/config/SYS_CONFIG_NAME.h
config SYS_CONFIG_NAME
	default "hc1726-agt726-7"

endif

if TARGET_AGT726_10

# board/SYS_VENDOR/SYS_BOARD
config SYS_VENDOR
	default "augentix"
config SYS_BOARD
	default "hc1726-tb012"
# include/config/SYS_CONFIG_NAME.h
config SYS_CONFIG_NAME
	default "hc1726-agt726-10"

endif

if TARGET_AGT726_11

# board/SYS_VENDOR/SYS_BOARD
config SYS_VENDOR
	default "augentix"
config SYS_BOARD
	default "hc1726-tb012"
# include/config/SYS_CONFIG_NAME.h
config SYS_CONFIG_NAME
	default "hc1726-agt726-11"

endif

if TARGET_AGT726_12

# board/SYS_VENDOR/SYS_BOARD
config SYS_VENDOR
	default "augentix"
config SYS_BOARD
	default "hc1726-tb012"
# include/config/SYS_CONFIG_NAME.h
config SYS_CONFIG_NAME
	default "hc1726-agt726-12"

endif


if TARGET_AGT726_7

# board/SYS_VENDOR/SYS_BOARD
config SYS_VENDOR
	default "augentix"
config SYS_BOARD
	default "hc1726-tb012"
# include/config/SYS_CONFIG_NAME.h
config SYS_CONFIG_NAME
	default "hc1726-agt726-7"

endif

if TARGET_DFN202_113002

# board/SYS_VENDOR/SYS_BOARD
config SYS_VENDOR
	default "augentix"
config SYS_BOARD
	default "hc1726-tb012"
# include/config/SYS_CONFIG_NAME.h
config SYS_CONFIG_NAME
	default "hc1726-dfn202-113002"

endif

if TARGET_STR726_13

# board/SYS_VENDOR/SYS_BOARD
config SYS_VENDOR
	default "augentix"
config SYS_BOARD
	default "hc1726-tb012"
# include/config/SYS_CONFIG_NAME.h
config SYS_CONFIG_NAME
	default "hc1726-str726-13"

endif
```

## bsp/sdk/bootloader/uboot/board/augentix/hc1726-tb013/Kconfig
```kconfig
if TARGET_AGT726_2

# board/SYS_VENDOR/SYS_BOARD
config SYS_VENDOR
	default "augentix"
config SYS_BOARD
	default "hc1726-tb013"
# include/config/SYS_CONFIG_NAME.h
config SYS_CONFIG_NAME
	default "hc1726-agt726-2"

endif
```

## bsp/sdk/bootloader/uboot/board/augentix/hc1753-tb007-slt/Kconfig
```kconfig
if TARGET_HC1753_TB007_SLT

# board/SYS_VENDOR/SYS_BOARD
config SYS_VENDOR
	default "augentix"
config SYS_BOARD
	default "hc1753-tb007-slt"
# include/config/SYS_CONFIG_NAME.h
config SYS_CONFIG_NAME
	default "hc1753-tb007-slt"

endif
```

## bsp/sdk/bootloader/uboot/board/augentix/hc1753-tb007/Kconfig
```kconfig
if TARGET_HC1753_TB007

# board/SYS_VENDOR/SYS_BOARD
config SYS_VENDOR
	default "augentix"
config SYS_BOARD
	default "hc1753-tb007"
# include/config/SYS_CONFIG_NAME.h
config SYS_CONFIG_NAME
	default "hc1753-tb007"

endif
```

## bsp/sdk/bootloader/uboot/board/augentix/hc1753s-tb006-slt/Kconfig
```kconfig
if TARGET_HC1753S_TB006_SLT

# board/SYS_VENDOR/SYS_BOARD
config SYS_VENDOR
	default "augentix"
config SYS_BOARD
	default "hc1753s-tb006-slt"
# include/config/SYS_CONFIG_NAME.h
config SYS_CONFIG_NAME
	default "hc1753s-tb006-slt"

endif
```

## bsp/sdk/bootloader/uboot/board/augentix/hc1783s-mb022/Kconfig
```kconfig
if TARGET_AGT800_40

# board/SYS_VENDOR/SYS_BOARD
config SYS_VENDOR
	default "augentix"
config SYS_BOARD
	default "hc1783s-mb022"
# include/config/SYS_CONFIG_NAME.h
config SYS_CONFIG_NAME
	default "hc1783s-agt800-40"

endif

if TARGET_AGT800_41

# board/SYS_VENDOR/SYS_BOARD
config SYS_VENDOR
	default "augentix"
config SYS_BOARD
	default "hc1783s-mb022"
# include/config/SYS_CONFIG_NAME.h
config SYS_CONFIG_NAME
	default "hc1783s-agt800-41"

endif

if TARGET_AGT783_4

# board/SYS_VENDOR/SYS_BOARD
config SYS_VENDOR
	default "augentix"
config SYS_BOARD
	default "hc1783s-mb022"
# include/config/SYS_CONFIG_NAME.h
config SYS_CONFIG_NAME
	default "hc1783s-agt783-4"

endif
```

## bsp/sdk/bootloader/uboot/board/augentix/hc1783s-tb006-nor-8mb/Kconfig
```kconfig
if TARGET_HC1783S_TB006_NOR_8MB

# board/SYS_VENDOR/SYS_BOARD
config SYS_VENDOR
	default "augentix"
config SYS_BOARD
	default "hc1783s-tb006-nor-8mb"
# include/config/SYS_CONFIG_NAME.h
config SYS_CONFIG_NAME
	default "hc1783s-tb006-nor-8mb"

endif

if TARGET_HC1783S_FPU_TB006_NOR_8MB

# board/SYS_VENDOR/SYS_BOARD
config SYS_VENDOR
	default "augentix"
config SYS_BOARD
	default "hc1783s-tb006-nor-8mb"
# include/config/SYS_CONFIG_NAME.h
config SYS_CONFIG_NAME
	default "hc1783s-fpu-tb006-nor-8mb"

endif
```

## bsp/sdk/bootloader/uboot/board/augentix/hc1783s-tb006-nor/Kconfig
```kconfig
if TARGET_HC1783S_TB006_NOR

# board/SYS_VENDOR/SYS_BOARD
config SYS_VENDOR
	default "augentix"
config SYS_BOARD
	default "hc1783s-tb006-nor"
# include/config/SYS_CONFIG_NAME.h
config SYS_CONFIG_NAME
	default "hc1783s-tb006-nor"

endif
```

## bsp/sdk/bootloader/uboot/board/augentix/hc1783s-tb006-slt/Kconfig
```kconfig
if TARGET_HC1783S_TB006_SLT

# board/SYS_VENDOR/SYS_BOARD
config SYS_VENDOR
	default "augentix"
config SYS_BOARD
	default "hc1783s-tb006-slt"
# include/config/SYS_CONFIG_NAME.h
config SYS_CONFIG_NAME
	default "hc1783s-tb006-slt"

endif
```

## bsp/sdk/bootloader/uboot/board/augentix/hc1783s-tb006/Kconfig
```kconfig
if TARGET_HC1783S_TB006

# board/SYS_VENDOR/SYS_BOARD
config SYS_VENDOR
	default "augentix"
config SYS_BOARD
	default "hc1783s-tb006"
# include/config/SYS_CONFIG_NAME.h
config SYS_CONFIG_NAME
	default "hc1783s-tb006"

endif
```

## bsp/sdk/bootloader/uboot/board/augentix/hc1785/Kconfig
```kconfig
if TARGET_AGT785_1

# board/SYS_VENDOR/SYS_BOARD
config SYS_VENDOR
	default "augentix"
config SYS_BOARD
	default "hc1785"
# include/config/SYS_CONFIG_NAME.h
config SYS_CONFIG_NAME
	default "hc1785-agt785-1"

endif
```

## bsp/sdk/bootloader/uboot/board/augentix/ihome1-ma804043-v3/Kconfig
```kconfig
if TARGET_AGT804_43

# board/SYS_VENDOR/SYS_BOARD
config SYS_VENDOR
	default "augentix"
config SYS_BOARD
	default "ihome1-ma804043-v3"
# include/config/SYS_CONFIG_NAME.h
config SYS_CONFIG_NAME
	default "hc1703-agt804-43"

endif
```

## bsp/sdk/bootloader/uboot/board/augentix/kamo/Kconfig
```kconfig
if TARGET_KAMO

# board/SYS_VENDOR/SYS_BOARD
config SYS_VENDOR
	default "augentix"
config SYS_BOARD
	default "kamo"
# include/config/SYS_CONFIG_NAME.h
config SYS_CONFIG_NAME
	default "kamo"

endif
```

## bsp/sdk/bootloader/uboot/board/augentix/mke_ma80030-V1/Kconfig
```kconfig
# Products using AGT_MA800030_V1 machine

if TARGET_AGT800_30

# board/SYS_VENDOR/SYS_BOARD
config SYS_VENDOR
        default "augentix"
config SYS_BOARD
        default "agt-ma800020-v1"
# include/config/SYS_CONFIG_NAME.h
config SYS_CONFIG_NAME
        default "hc1783s-fpu-agt800-30"

endif

if TARGET_AGT800_31

# board/SYS_VENDOR/SYS_BOARD
config SYS_VENDOR
        default "augentix"
config SYS_BOARD
        default "agt-ma800020-v1"
# include/config/SYS_CONFIG_NAME.h
config SYS_CONFIG_NAME
        default "hc1783s-fpu-agt800-31"

endif
```

## bsp/sdk/bootloader/uboot/board/augentix/osaka/Kconfig
```kconfig
if TARGET_OSAKA

# board/SYS_VENDOR/SYS_BOARD
config SYS_VENDOR
	default "augentix"
config SYS_BOARD
	default "osaka"
# include/config/SYS_CONFIG_NAME.h
config SYS_CONFIG_NAME
	default "osaka"

endif
```

## bsp/sdk/bootloader/uboot/board/augentix/sapporo/Kconfig
```kconfig
if TARGET_SAPPORO

# board/SYS_VENDOR/SYS_BOARD
config SYS_VENDOR
	default "augentix"
config SYS_BOARD
	default "sapporo"
# include/config/SYS_CONFIG_NAME.h
config SYS_CONFIG_NAME
	default "sapporo"

endif
```

## bsp/sdk/bootloader/uboot/drivers/adc/Kconfig
```kconfig
config ADC
	bool "Enable ADC drivers using Driver Model"
	help
	  This enables ADC API for drivers, which allows driving ADC features
	  by single and multi-channel methods for:
	  - start/stop/get data for conversion of a single-channel selected by
	    a number or multi-channels selected by a bitmask
	  - get data mask (ADC resolution)
	  ADC reference Voltage supply options:
	  - methods for get Vdd/Vss reference Voltage values with polarity
	  - support supply's phandle with auto-enable
	  - supply polarity setting in fdt

config ADC_EXYNOS
	bool "Enable Exynos 54xx ADC driver"
	help
	  This enables basic driver for Exynos ADC compatible with Exynos54xx.
	  It provides:
	  - 10 analog input channels
	  - 12-bit resolution
	  - 600 KSPS of sample rate

config ADC_SANDBOX
	bool "Enable Sandbox ADC test driver"
	help
	  This enables driver for Sandbox ADC device emulation.
	  It provides:
	  - 4 analog input channels
	  - 16-bit resolution
	  - single and multi-channel conversion mode

config ADC_AUGENTIX
	bool "Enable Augentix ADC test driver"
	depends on ARCH_HC1703_1723_1753_1783S
	default y
	help
	  This enables driver for Augentix ADC.
	  It provides:
	  - 5 analog input channels
	  - 12-bit resolution

config ADC_AUGENTIX_V2
	bool "Enable Augentix ADC test driver V2"
	depends on (ARCH_SAPPORO || ARCH_KAMO)
	default y
	help
	  This enables driver for Augentix ADC V2.
	  It provides:
	  - 3 analog input channels
	  - 8-bit resolution
```

## bsp/sdk/bootloader/uboot/drivers/sensor/Kconfig
```kconfig
#
# Image Sensor configuration
#

menuconfig IMAGE_SENSOR
	bool "Image sensor support"
	help
		Enable image sensor support

		Paragraph 2

if IMAGE_SENSOR

config LIGHT_METER
	bool "Use a light meter to set the initial exposure"

config VERBOSE
	bool "Print debug informations"
	default n
	help
		Shows details

endif # IMAGE_SENSOR
```
