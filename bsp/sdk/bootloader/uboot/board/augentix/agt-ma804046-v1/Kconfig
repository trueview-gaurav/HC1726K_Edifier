## bsp/sdk/bootloader/uboot/board/augentix/agt-ma804046-v1/Kconfig
```kconfig
if TARGET_AGT804_46

# board/SYS_VENDOR/SYS_BOARD
config SYS_VENDOR
	default "augentix"
config SYS_BOARD
	default "agt-ma804046-v1"
# include/config/SYS_CONFIG_NAME.h
config SYS_CONFIG_NAME
	default "hc1705-agt804-46"

endif
```

## bsp/sdk/bootloader/uboot/board/augentix/hc1703-tb008-nor-8mb/Kconfig
```kconfig
if TARGET_HC1703_TB008_NOR_8MB

# board/SYS_VENDOR/SYS_BOARD
config SYS_VENDOR
	default "augentix"
config SYS_BOARD
	default "hc1703-tb008-nor-8mb"
# include/config/SYS_CONFIG_NAME.h
config SYS_CONFIG_NAME
	default "hc1703-tb008-nor-8mb"

endif

if TARGET_HC1703L_TB008_NOR_8MB

# board/SYS_VENDOR/SYS_BOARD
config SYS_VENDOR
	default "augentix"
config SYS_BOARD
	default "hc1703-tb008-nor-8mb"
# include/config/SYS_CONFIG_NAME.h
config SYS_CONFIG_NAME
	default "hc1703l-tb008-nor-8mb"

endif
```

## bsp/sdk/bootloader/uboot/board/augentix/hc1703-tb008-nor/Kconfig
```kconfig
if TARGET_HC1703_TB008_NOR

# board/SYS_VENDOR/SYS_BOARD
config SYS_VENDOR
	default "augentix"
config SYS_BOARD
	default "hc1703-tb008-nor"
# include/config/SYS_CONFIG_NAME.h
config SYS_CONFIG_NAME
	default "hc1703-tb008-nor"

endif
```

## bsp/sdk/bootloader/uboot/board/augentix/hc1703-tb008-slt/Kconfig
```kconfig
if TARGET_HC1703_TB008_SLT

# board/SYS_VENDOR/SYS_BOARD
config SYS_VENDOR
	default "augentix"
config SYS_BOARD
	default "hc1703-tb008-slt"
# include/config/SYS_CONFIG_NAME.h
config SYS_CONFIG_NAME
	default "hc1703-tb008-slt"

endif
```

## bsp/sdk/bootloader/uboot/board/augentix/hc1703-tb008/Kconfig
```kconfig
if TARGET_HC1703_TB008

# board/SYS_VENDOR/SYS_BOARD
config SYS_VENDOR
	default "augentix"
config SYS_BOARD
	default "hc1703-tb008"
# include/config/SYS_CONFIG_NAME.h
config SYS_CONFIG_NAME
	default "hc1703-tb008"

endif
```

## bsp/sdk/bootloader/uboot/board/augentix/hc1703_1723_1753_1783s/Kconfig
```kconfig
if TARGET_HC1703_1723_1753_1783S

# board/SYS_VENDOR/SYS_BOARD
config SYS_VENDOR
	default "augentix"
config SYS_BOARD
	default "hc1703_1723_1753_1783s"
# include/config/SYS_CONFIG_NAME.h
config SYS_CONFIG_NAME
	default "hc1703_1723_1753_1783s"

endif
```

## bsp/sdk/bootloader/uboot/board/augentix/hc1703l-mb021-nor-8mb/Kconfig
```kconfig
if TARGET_HC1703L_MB021_NOR_8MB

# board/SYS_VENDOR/SYS_BOARD
config SYS_VENDOR
	default "augentix"
config SYS_BOARD
	default "hc1703l-mb021-nor-8mb"
# include/config/SYS_CONFIG_NAME.h
config SYS_CONFIG_NAME
	default "hc1703l-mb021-nor-8mb"

endif
```

## bsp/sdk/bootloader/uboot/board/augentix/hc1703l-tb008-slt/Kconfig
```kconfig
if TARGET_HC1703L_TB008_SLT

# board/SYS_VENDOR/SYS_BOARD
config SYS_VENDOR
	default "augentix"
config SYS_BOARD
	default "hc1703l-tb008-slt"
# include/config/SYS_CONFIG_NAME.h
config SYS_CONFIG_NAME
	default "hc1703l-tb008-slt"

endif
```

## bsp/sdk/bootloader/uboot/board/augentix/hc1705-mb021/Kconfig
```kconfig
if TARGET_AGT201_20

# board/SYS_VENDOR/SYS_BOARD
config SYS_VENDOR
	default "augentix"
config SYS_BOARD
	default "hc1705-mb021"
# include/config/SYS_CONFIG_NAME.h
config SYS_CONFIG_NAME
	default "hc1705-agt201-20"

endif


if TARGET_HC1705_MB021_NOR_8MB

# board/SYS_VENDOR/SYS_BOARD
config SYS_VENDOR
	default "augentix"
config SYS_BOARD
	default "hc1705-mb021"
# include/config/SYS_CONFIG_NAME.h
config SYS_CONFIG_NAME
	default "hc1705-mb021-nor-8mb"

endif

if TARGET_AGT201_22

# board/SYS_VENDOR/SYS_BOARD
config SYS_VENDOR
	default "augentix"
config SYS_BOARD
	default "hc1705-mb021"
# include/config/SYS_CONFIG_NAME.h
config SYS_CONFIG_NAME
	default "hc1705-agt201-22"

endif

if TARGET_AGT100_25

# board/SYS_VENDOR/SYS_BOARD
config SYS_VENDOR
	default "augentix"
config SYS_BOARD
	default "hc1705-mb021"
# include/config/SYS_CONFIG_NAME.h
config SYS_CONFIG_NAME
	default "hc1705-agt100-25"

endif

if TARGET_AGT302_20

# board/SYS_VENDOR/SYS_BOARD
config SYS_VENDOR
	default "augentix"
config SYS_BOARD
	default "hc1705-mb021"
# include/config/SYS_CONFIG_NAME.h
config SYS_CONFIG_NAME
	default "hc1705-agt302-20"

endif

if TARGET_AGT201_23

# board/SYS_VENDOR/SYS_BOARD
config SYS_VENDOR
	default "augentix"
config SYS_BOARD
	default "hc1705-mb021"
# include/config/SYS_CONFIG_NAME.h
config SYS_CONFIG_NAME
	default "hc1705-agt201-23"

endif
```

## bsp/sdk/bootloader/uboot/board/augentix/hc1705i-tb008-slt/Kconfig
```kconfig
if TARGET_HC1705I_TB008_SLT

# board/SYS_VENDOR/SYS_BOARD
config SYS_VENDOR
	default "augentix"
config SYS_BOARD
	default "hc1705i-tb008-slt"
# include/config/SYS_CONFIG_NAME.h
config SYS_CONFIG_NAME
	default "hc1705i-tb008-slt"

endif
```

## bsp/sdk/bootloader/uboot/board/augentix/hc1705k-mb026/Kconfig
```kconfig
if TARGET_AGT804_49

# board/SYS_VENDOR/SYS_BOARD
config SYS_VENDOR
	default "augentix"
config SYS_BOARD
	default "hc1705k-mb026"
# include/config/SYS_CONFIG_NAME.h
config SYS_CONFIG_NAME
	default "hc1705k-agt804-49"

endif
```

## bsp/sdk/bootloader/uboot/board/augentix/hc1705k-tb008-slt/Kconfig
```kconfig
if TARGET_HC1705K_TB008_SLT

# board/SYS_VENDOR/SYS_BOARD
config SYS_VENDOR
	default "augentix"
config SYS_BOARD
	default "hc1705k-tb008-slt"
# include/config/SYS_CONFIG_NAME.h
config SYS_CONFIG_NAME
	default "hc1705k-tb008-slt"

endif
```

## bsp/sdk/bootloader/uboot/board/augentix/hc1705l/Kconfig
```kconfig
if TARGET_AGT705_8

# board/SYS_VENDOR/SYS_BOARD
config SYS_VENDOR
	default "augentix"
config SYS_BOARD
	default "hc1705l"
# include/config/SYS_CONFIG_NAME.h
config SYS_CONFIG_NAME
	default "hc1705l-agt705-8"

endif
```

## bsp/sdk/bootloader/uboot/board/augentix/hc1706-tb010/Kconfig
```kconfig
if TARGET_AGT706_1

# board/SYS_VENDOR/SYS_BOARD
config SYS_VENDOR
	default "augentix"
config SYS_BOARD
	default "hc1706-tb010"
# include/config/SYS_CONFIG_NAME.h
config SYS_CONFIG_NAME
	default "hc1706-agt706-1"

endif

if TARGET_AGT706_1_AMP

# board/SYS_VENDOR/SYS_BOARD
config SYS_VENDOR
	default "augentix"
config SYS_BOARD
	default "hc1706-tb010"
# include/config/SYS_CONFIG_NAME.h
config SYS_CONFIG_NAME
	default "hc1706-agt706-1-amp"

endif

if TARGET_AGT706_1_NAND

# board/SYS_VENDOR/SYS_BOARD
config SYS_VENDOR
	default "augentix"
config SYS_BOARD
	default "hc1706-tb010"
# include/config/SYS_CONFIG_NAME.h
config SYS_CONFIG_NAME
	default "hc1706-agt706-1-nand"

endif

if TARGET_AGT706_4

# board/SYS_VENDOR/SYS_BOARD
config SYS_VENDOR
	default "augentix"
config SYS_BOARD
	default "hc1706-tb010"
# include/config/SYS_CONFIG_NAME.h
config SYS_CONFIG_NAME
	default "hc1706-agt706-4"

endif

if TARGET_HC1706_TB010_SLT

# board/SYS_VENDOR/SYS_BOARD
config SYS_VENDOR
	default "augentix"
config SYS_BOARD
	default "hc1706-tb010"
# include/config/SYS_CONFIG_NAME.h
config SYS_CONFIG_NAME
	default "hc1706-tb010-slt"

endif

if TARGET_AGT706_9

# board/SYS_VENDOR/SYS_BOARD
config SYS_VENDOR
	default "augentix"
config SYS_BOARD
	default "hc1706-tb010"
# include/config/SYS_CONFIG_NAME.h
config SYS_CONFIG_NAME
	default "hc1706h-agt706-9"

endif

if TARGET_AGT706_10

# board/SYS_VENDOR/SYS_BOARD
config SYS_VENDOR
	default "augentix"
config SYS_BOARD
	default "hc1706-tb010"
# include/config/SYS_CONFIG_NAME.h
config SYS_CONFIG_NAME
	default "hc1706h-agt706-10"

endif
```

## bsp/sdk/bootloader/uboot/board/augentix/hc1706h-mb033/Kconfig
```kconfig
if TARGET_AGT706_3

# board/SYS_VENDOR/SYS_BOARD
config SYS_VENDOR
	default "augentix"
config SYS_BOARD
	default "hc1706h-mb033"
# include/config/SYS_CONFIG_NAME.h
config SYS_CONFIG_NAME
	default "hc1706h-agt706-3"

endif

if TARGET_AGT706_6

# board/SYS_VENDOR/SYS_BOARD
config SYS_VENDOR
	default "augentix"
config SYS_BOARD
	default "hc1706h-mb033"
# include/config/SYS_CONFIG_NAME.h
config SYS_CONFIG_NAME
	default "hc1706h-agt706-6"

endif

if TARGET_AGT706_11

# board/SYS_VENDOR/SYS_BOARD
config SYS_VENDOR
	default "augentix"
config SYS_BOARD
	default "hc1706h-mb033"
# include/config/SYS_CONFIG_NAME.h
config SYS_CONFIG_NAME
	default "hc1706h-agt706-11"

endif

if TARGET_AGT706_12

# board/SYS_VENDOR/SYS_BOARD
config SYS_VENDOR
	default "augentix"
config SYS_BOARD
	default "hc1706h-mb033"
# include/config/SYS_CONFIG_NAME.h
config SYS_CONFIG_NAME
	default "hc1706h-agt706-12"

endif

if TARGET_AGT706_13

# board/SYS_VENDOR/SYS_BOARD
config SYS_VENDOR
	default "augentix"
config SYS_BOARD
	default "hc1706h-mb033"
# include/config/SYS_CONFIG_NAME.h
config SYS_CONFIG_NAME
	default "hc1706h-agt706-13"

endif
```

## bsp/sdk/bootloader/uboot/board/augentix/hc1706h-tb010/Kconfig
```kconfig
if TARGET_HC1706H_TB010_SLT

# board/SYS_VENDOR/SYS_BOARD
config SYS_VENDOR
	default "augentix"
config SYS_BOARD
	default "hc1706h-tb010"
# include/config/SYS_CONFIG_NAME.h
config SYS_CONFIG_NAME
	default "hc1706h-tb010-slt"

endif
```

## bsp/sdk/bootloader/uboot/board/augentix/hc1706k-mb033/Kconfig
```kconfig
if TARGET_AGT706_2

# board/SYS_VENDOR/SYS_BOARD
config SYS_VENDOR
	default "augentix"
config SYS_BOARD
	default "hc1706k-mb033"
# include/config/SYS_CONFIG_NAME.h
config SYS_CONFIG_NAME
	default "hc1706k-agt706-2"

endif

if TARGET_AGT706_2_NAND

# board/SYS_VENDOR/SYS_BOARD
config SYS_VENDOR
	default "augentix"
config SYS_BOARD
	default "hc1706k-mb033"
# include/config/SYS_CONFIG_NAME.h
config SYS_CONFIG_NAME
	default "hc1706k-agt706-2-nand"

endif

if TARGET_AGT706_8

# board/SYS_VENDOR/SYS_BOARD
config SYS_VENDOR
	default "augentix"
config SYS_BOARD
	default "hc1706k-mb033"
# include/config/SYS_CONFIG_NAME.h
config SYS_CONFIG_NAME
	default "hc1706k-agt706-8"

endif

if TARGET_AGT706_14

# board/SYS_VENDOR/SYS_BOARD
config SYS_VENDOR
	default "augentix"
config SYS_BOARD
	default "hc1706k-mb033"
# include/config/SYS_CONFIG_NAME.h
config SYS_CONFIG_NAME
	default "hc1706k-agt706-14"

endif
```

## bsp/sdk/bootloader/uboot/board/augentix/hc1706k-mb035/Kconfig
```kconfig
if TARGET_AGT706_7

# board/SYS_VENDOR/SYS_BOARD
config SYS_VENDOR
	default "augentix"
config SYS_BOARD
	default "hc1706k-mb035"
# include/config/SYS_CONFIG_NAME.h
config SYS_CONFIG_NAME
	default "hc1706k-agt706-7"

endif

if TARGET_AGT706_15

# board/SYS_VENDOR/SYS_BOARD
config SYS_VENDOR
	default "augentix"
config SYS_BOARD
	default "hc1706k-mb035"
# include/config/SYS_CONFIG_NAME.h
config SYS_CONFIG_NAME
	default "hc1706k-agt706-15"

endif
```

## bsp/sdk/bootloader/uboot/board/augentix/hc1706k-tb010/Kconfig
```kconfig
if TARGET_AGT706_5

# board/SYS_VENDOR/SYS_BOARD
config SYS_VENDOR
	default "augentix"
config SYS_BOARD
	default "hc1706k-tb010"
# include/config/SYS_CONFIG_NAME.h
config SYS_CONFIG_NAME
	default "hc1706k-agt706-5"

endif

if TARGET_HC1706K_TB010_SLT

# board/SYS_VENDOR/SYS_BOARD
config SYS_VENDOR
	default "augentix"
config SYS_BOARD
	default "hc1706k-tb010"
# include/config/SYS_CONFIG_NAME.h
config SYS_CONFIG_NAME
	default "hc1706k-tb010-slt"

endif
```

## bsp/sdk/bootloader/uboot/board/augentix/hc1715-tb007-slt/Kconfig
```kconfig
if TARGET_HC1715_TB007_SLT

# board/SYS_VENDOR/SYS_BOARD
config SYS_VENDOR
	default "augentix"
config SYS_BOARD
	default "hc1715-tb007-slt"
# include/config/SYS_CONFIG_NAME.h
config SYS_CONFIG_NAME
	default "hc1715-tb007-slt"

endif
```

## bsp/sdk/bootloader/uboot/board/augentix/hc1715-tb007/Kconfig
```kconfig
if TARGET_HC1715_TB007

# board/SYS_VENDOR/SYS_BOARD
config SYS_VENDOR
	default "augentix"
config SYS_BOARD
	default "hc1715-tb007"
# include/config/SYS_CONFIG_NAME.h
config SYS_CONFIG_NAME
	default "hc1715-tb007"

endif

if TARGET_AGT100_23

# board/SYS_VENDOR/SYS_BOARD
config SYS_VENDOR
	default "augentix"
config SYS_BOARD
	default "hc1715-tb007"
# include/config/SYS_CONFIG_NAME.h
config SYS_CONFIG_NAME
	default "hc1715-agt100-23"

endif

if TARGET_AGT100_24

# board/SYS_VENDOR/SYS_BOARD
config SYS_VENDOR
	default "augentix"
config SYS_BOARD
	default "hc1715-tb007"
# include/config/SYS_CONFIG_NAME.h
config SYS_CONFIG_NAME
	default "hc1715-agt100-24"

endif

if TARGET_AGT301_21

# board/SYS_VENDOR/SYS_BOARD
config SYS_VENDOR
	default "augentix"
config SYS_BOARD
	default "hc1715-tb007"
# include/config/SYS_CONFIG_NAME.h
config SYS_CONFIG_NAME
	default "hc1715-agt301-21"

endif
```

## bsp/sdk/bootloader/uboot/board/augentix/hc1723-mb023-nor-8mb/Kconfig
```kconfig
if TARGET_HC1723_MB023_NOR_8MB

# board/SYS_VENDOR/SYS_BOARD
config SYS_VENDOR
	default "augentix"
config SYS_BOARD
	default "hc1723-mb023-nor-8mb"
# include/config/SYS_CONFIG_NAME.h
config SYS_CONFIG_NAME
	default "hc1723-mb023-nor-8mb"

endif
```

## bsp/sdk/bootloader/uboot/board/augentix/hc1723-tb007-slt/Kconfig
```kconfig
if TARGET_HC1723_TB007_SLT

# board/SYS_VENDOR/SYS_BOARD
config SYS_VENDOR
	default "augentix"
config SYS_BOARD
	default "hc1723-tb007-slt"
# include/config/SYS_CONFIG_NAME.h
config SYS_CONFIG_NAME
	default "hc1723-tb007-slt"

endif
```
