## bsp/sdk/bootloader/uboot/board/augentix/agt-ma001027-v1/Kconfig
```kconfig
if TARGET_AGT001_27

# board/SYS_VENDOR/SYS_BOARD
config SYS_VENDOR
	default "augentix"
config SYS_BOARD
	default "agt-ma001027-v1"
# include/config/SYS_CONFIG_NAME.h
config SYS_CONFIG_NAME
	default "hc1705-agt001-27"

endif
```

## bsp/sdk/bootloader/uboot/board/augentix/agt-ma001028-v1/Kconfig
```kconfig
if TARGET_AGT001_28

# board/SYS_VENDOR/SYS_BOARD
config SYS_VENDOR
	default "augentix"
config SYS_BOARD
	default "agt-ma001028-v1"
# include/config/SYS_CONFIG_NAME.h
config SYS_CONFIG_NAME
	default "hc1705-agt001-28"

endif
```

## bsp/sdk/bootloader/uboot/board/augentix/agt-ma001029-v1/Kconfig
```kconfig
if TARGET_AGT001_29

# board/SYS_VENDOR/SYS_BOARD
config SYS_VENDOR
	default "augentix"
config SYS_BOARD
	default "agt-ma001029-v1"
# include/config/SYS_CONFIG_NAME.h
config SYS_CONFIG_NAME
	default "hc1725-fpu-agt001-29"

endif
```

## bsp/sdk/bootloader/uboot/board/augentix/agt-ma100027-v1/Kconfig
```kconfig
if TARGET_AGT100_27

# board/SYS_VENDOR/SYS_BOARD
config SYS_VENDOR
	default "augentix"
config SYS_BOARD
	default "agt-ma100027-v1"
# include/config/SYS_CONFIG_NAME.h
config SYS_CONFIG_NAME
	default "hc1703l-agt100-27"

endif
```

## bsp/sdk/bootloader/uboot/board/augentix/agt-ma100030-v1/Kconfig
```kconfig
if TARGET_AGT100_30

# board/SYS_VENDOR/SYS_BOARD
config SYS_VENDOR
	default "augentix"
config SYS_BOARD
	default "agt-ma100030-v1"
# include/config/SYS_CONFIG_NAME.h
config SYS_CONFIG_NAME
	default "hc1723i-agt100-30"

endif
```

## bsp/sdk/bootloader/uboot/board/augentix/agt-ma200021-v1/Kconfig
```kconfig
# Products using AGT_MA800020_V1 machine
if TARGET_AGT800_20

# board/SYS_VENDOR/SYS_BOARD
config SYS_VENDOR
	default "augentix"
config SYS_BOARD
	default "agt-ma800020-v1"
# include/config/SYS_CONFIG_NAME.h
config SYS_CONFIG_NAME
	default "hc1783s-agt800-20"

endif

if TARGET_AGT800_23

# board/SYS_VENDOR/SYS_BOARD
config SYS_VENDOR
	default "augentix"
config SYS_BOARD
	default "agt-ma800020-v1"
# include/config/SYS_CONFIG_NAME.h
config SYS_CONFIG_NAME
	default "hc1783s-fpu-agt800-23"

endif

if TARGET_AGT800_30

# board/SYS_VENDOR/SYS_BOARD
config SYS_VENDOR
        default "augentix"
config SYS_BOARD
        default "agt-ma800020-v1"
# include/config/SYS_CONFIG_NAME.h
config SYS_CONFIG_NAME
        default "hc1783s-fpu-agt800-30"

endif

if TARGET_AGT800_31

# board/SYS_VENDOR/SYS_BOARD
config SYS_VENDOR
        default "augentix"
config SYS_BOARD
        default "agt-ma800020-v1"
# include/config/SYS_CONFIG_NAME.h
config SYS_CONFIG_NAME
        default "hc1783s-fpu-agt800-31"

endif

if TARGET_AGT800_34

# board/SYS_VENDOR/SYS_BOARD
config SYS_VENDOR
        default "augentix"
config SYS_BOARD
        default "agt-ma800020-v1"
# include/config/SYS_CONFIG_NAME.h
config SYS_CONFIG_NAME
        default "hc1783s-agt800-34"

endif

if TARGET_AGT800_35

# board/SYS_VENDOR/SYS_BOARD
config SYS_VENDOR
        default "augentix"
config SYS_BOARD
        default "agt-ma800020-v1"
# include/config/SYS_CONFIG_NAME.h
config SYS_CONFIG_NAME
        default "hc1783s-agt800-35"

endif

if TARGET_AGT800_36

# board/SYS_VENDOR/SYS_BOARD
config SYS_VENDOR
        default "augentix"
config SYS_BOARD
        default "agt-ma800020-v1"
# include/config/SYS_CONFIG_NAME.h
config SYS_CONFIG_NAME
        default "hc1783s-agt800-36"

endif

if TARGET_AGT200_20

# board/SYS_VENDOR/SYS_BOARD
config SYS_VENDOR
        default "augentix"
config SYS_BOARD
        default "agt-ma800020-v1"
# include/config/SYS_CONFIG_NAME.h
config SYS_CONFIG_NAME
        default "hc1783s-fpu-agt200-20"

endif

if TARGET_AGT200_21

# board/SYS_VENDOR/SYS_BOARD
config SYS_VENDOR
        default "augentix"
config SYS_BOARD
        default "agt-ma200021-v1"
# include/config/SYS_CONFIG_NAME.h
config SYS_CONFIG_NAME
        default "hc1783s-fpu-agt200-21"

endif

if TARGET_AGT804_37

# board/SYS_VENDOR/SYS_BOARD
config SYS_VENDOR
        default "augentix"
config SYS_BOARD
        default "agt-ma800020-v1"
# include/config/SYS_CONFIG_NAME.h
config SYS_CONFIG_NAME
        default "hc1783s-agt804-37"

endif

if TARGET_AGT804_38

# board/SYS_VENDOR/SYS_BOARD
config SYS_VENDOR
        default "augentix"
config SYS_BOARD
        default "agt-ma800020-v1"
# include/config/SYS_CONFIG_NAME.h
config SYS_CONFIG_NAME
        default "hc1783s-agt804-38"

endif

if TARGET_AGT100_21

# board/SYS_VENDOR/SYS_BOARD
config SYS_VENDOR
        default "augentix"
config SYS_BOARD
        default "agt-ma800020-v1"
# include/config/SYS_CONFIG_NAME.h
config SYS_CONFIG_NAME
        default "hc1783s-fpu-agt100-21"

endif

if TARGET_AGT800_42

# board/SYS_VENDOR/SYS_BOARD
config SYS_VENDOR
        default "augentix"
config SYS_BOARD
        default "agt-ma800020-v1"
# include/config/SYS_CONFIG_NAME.h
config SYS_CONFIG_NAME
        default "hc1783s-fpu-agt800-42"

endif
```

## bsp/sdk/bootloader/uboot/board/augentix/agt-ma300027-v1/Kconfig
```kconfig
if TARGET_AGT300_27

# board/SYS_VENDOR/SYS_BOARD
config SYS_VENDOR
	default "augentix"
config SYS_BOARD
	default "agt-ma300027-v1"
# include/config/SYS_CONFIG_NAME.h
config SYS_CONFIG_NAME
	default "hc1725-fpu-agt300-27"

endif

if TARGET_AGT300_30

# board/SYS_VENDOR/SYS_BOARD
config SYS_VENDOR
	default "augentix"
config SYS_BOARD
	default "agt-ma300027-v1"
# include/config/SYS_CONFIG_NAME.h
config SYS_CONFIG_NAME
	default "hc1725-fpu-agt300-30"

endif
```

## bsp/sdk/bootloader/uboot/board/augentix/agt-ma300028-v1/Kconfig
```kconfig
if TARGET_AGT300_28

# board/SYS_VENDOR/SYS_BOARD
config SYS_VENDOR
	default "augentix"
config SYS_BOARD
	default "agt-ma300028-v1"
# include/config/SYS_CONFIG_NAME.h
config SYS_CONFIG_NAME
	default "hc1725-fpu-agt300-28"

endif
```

## bsp/sdk/bootloader/uboot/board/augentix/agt-ma300029-v1/Kconfig
```kconfig
# Products using AGT_MA300029_V1 machine

if TARGET_AGT300_29

# board/SYS_VENDOR/SYS_BOARD
config SYS_VENDOR
	default "augentix"
config SYS_BOARD
	default "agt-ma300029-v1"
# include/config/SYS_CONFIG_NAME.h
config SYS_CONFIG_NAME
	default "hc1783s-fpu-agt300-29"

endif
```

## bsp/sdk/bootloader/uboot/board/augentix/agt-ma705003-v1/Kconfig
```kconfig
if TARGET_AGT705_3

# board/SYS_VENDOR/SYS_BOARD
config SYS_VENDOR
	default "augentix"
config SYS_BOARD
	default "agt-ma705003-v1"
# include/config/SYS_CONFIG_NAME.h
config SYS_CONFIG_NAME
	default "hc1705k-agt705-3"

endif
```

## bsp/sdk/bootloader/uboot/board/augentix/agt-ma705004-v1/Kconfig
```kconfig
if TARGET_AGT705_4

# board/SYS_VENDOR/SYS_BOARD
config SYS_VENDOR
	default "augentix"
config SYS_BOARD
	default "agt-ma705004-v1"
# include/config/SYS_CONFIG_NAME.h
config SYS_CONFIG_NAME
	default "hc1705k-agt705-4"

endif
```

## bsp/sdk/bootloader/uboot/board/augentix/agt-ma705007-v1/Kconfig
```kconfig
if TARGET_AGT705_7

# board/SYS_VENDOR/SYS_BOARD
config SYS_VENDOR
	default "augentix"
config SYS_BOARD
	default "agt-ma705007-v1"
# include/config/SYS_CONFIG_NAME.h
config SYS_CONFIG_NAME
	default "hc1705k-agt705-7"

endif
```

## bsp/sdk/bootloader/uboot/board/augentix/agt-ma725012-v1/Kconfig
```kconfig
if TARGET_AGT725_12

# board/SYS_VENDOR/SYS_BOARD
config SYS_VENDOR
	default "augentix"
config SYS_BOARD
	default "agt-ma725012-v1"
# include/config/SYS_CONFIG_NAME.h
config SYS_CONFIG_NAME
	default "hc1725-agt725-12"

endif
```

## bsp/sdk/bootloader/uboot/board/augentix/agt-ma800022-v1/Kconfig
```kconfig
# Products using AGT_MA800022_V1 machine

if TARGET_AGT800_22

# board/SYS_VENDOR/SYS_BOARD
config SYS_VENDOR
	default "augentix"
config SYS_BOARD
	default "agt-ma800022-v1"
# include/config/SYS_CONFIG_NAME.h
config SYS_CONFIG_NAME
	default "hc1783s-fpu-agt800-22"

endif

if TARGET_AGT007_21

# board/SYS_VENDOR/SYS_BOARD
config SYS_VENDOR
	default "augentix"
config SYS_BOARD
	default "agt-ma800022-v1"
# include/config/SYS_CONFIG_NAME.h
config SYS_CONFIG_NAME
	default "hc1783s-fpu-agt007-21"

endif

if TARGET_AGT800_39

# board/SYS_VENDOR/SYS_BOARD
config SYS_VENDOR
	default "augentix"
config SYS_BOARD
	default "agt-ma800022-v1"
# include/config/SYS_CONFIG_NAME.h
config SYS_CONFIG_NAME
	default "hc1783s-fpu-agt800-39"

endif

if TARGET_AGT300_25

# board/SYS_VENDOR/SYS_BOARD
config SYS_VENDOR
	default "augentix"
config SYS_BOARD
	default "agt-ma800022-v1"
# include/config/SYS_CONFIG_NAME.h
config SYS_CONFIG_NAME
	default "hc1783s-fpu-agt300-25"

endif
```

## bsp/sdk/bootloader/uboot/board/augentix/agt-ma800027-v1/Kconfig
```kconfig
if TARGET_AGT800_27

# board/SYS_VENDOR/SYS_BOARD
config SYS_VENDOR
	default "augentix"
config SYS_BOARD
	default "agt-ma800027-v1"
# include/config/SYS_CONFIG_NAME.h
config SYS_CONFIG_NAME
	default "hc1753-fpu-agt800-27"

endif

if TARGET_AGT800_37

# board/SYS_VENDOR/SYS_BOARD
config SYS_VENDOR
	default "augentix"
config SYS_BOARD
	default "agt-ma800027-v1"
# include/config/SYS_CONFIG_NAME.h
config SYS_CONFIG_NAME
	default "hc1753-agt800-37"

endif

if TARGET_AGT803_20

# board/SYS_VENDOR/SYS_BOARD
config SYS_VENDOR
	default "augentix"
config SYS_BOARD
	default "agt-ma800027-v1"
# include/config/SYS_CONFIG_NAME.h
config SYS_CONFIG_NAME
	default "hc1753-agt800-37"

endif

if TARGET_AGT300_26

# board/SYS_VENDOR/SYS_BOARD
config SYS_VENDOR
	default "augentix"
config SYS_BOARD
	default "agt-ma800027-v1"
# include/config/SYS_CONFIG_NAME.h
config SYS_CONFIG_NAME
	default "hc1753-fpu-agt300-26"

endif
```

## bsp/sdk/bootloader/uboot/board/augentix/agt-ma800033-v1/Kconfig
```kconfig
# Products using AGT_MA800033_V1 machine
if TARGET_AGT800_33

# board/SYS_VENDOR/SYS_BOARD
config SYS_VENDOR
	default "augentix"
config SYS_BOARD
	default "agt-ma800033-v1"
# include/config/SYS_CONFIG_NAME.h
config SYS_CONFIG_NAME
	default "hc1783s-agt800-33"

endif
```

## bsp/sdk/bootloader/uboot/board/augentix/agt-ma800038-v1/Kconfig
```kconfig
if TARGET_AGT800_38

# board/SYS_VENDOR/SYS_BOARD
config SYS_VENDOR
	default "augentix"
config SYS_BOARD
	default "agt-ma800038-v1"
# include/config/SYS_CONFIG_NAME.h
config SYS_CONFIG_NAME
	default "hc1725-fpu-agt800-38"

endif
```

## bsp/sdk/bootloader/uboot/board/augentix/agt-ma800045-v1/Kconfig
```kconfig
if TARGET_AGT800_45

# board/SYS_VENDOR/SYS_BOARD
config SYS_VENDOR
	default "augentix"
config SYS_BOARD
	default "agt-ma800045-v1"
# include/config/SYS_CONFIG_NAME.h
config SYS_CONFIG_NAME
	default "hc1725-agt800-45"

endif
```

## bsp/sdk/bootloader/uboot/board/augentix/agt-ma800046-v1/Kconfig
```kconfig
if TARGET_AGT800_46

# board/SYS_VENDOR/SYS_BOARD
config SYS_VENDOR
	default "augentix"
config SYS_BOARD
	default "agt-ma800046-v1"
# include/config/SYS_CONFIG_NAME.h
config SYS_CONFIG_NAME
	default "hc1753s-agt800-46"

endif
```

## bsp/sdk/bootloader/uboot/board/augentix/agt-ma804020-v1/Kconfig
```kconfig
# Products using AGT_MA804020_V1 machine
if TARGET_AGT804_20

# board/SYS_VENDOR/SYS_BOARD
config SYS_VENDOR
	default "augentix"
config SYS_BOARD
	default "agt-ma804020-v1"
# include/config/SYS_CONFIG_NAME.h
config SYS_CONFIG_NAME
	default "hc1703-agt804-20"

endif
```

## bsp/sdk/bootloader/uboot/board/augentix/agt-ma804025-v1/Kconfig
```kconfig
if TARGET_AGT804_25

# board/SYS_VENDOR/SYS_BOARD
config SYS_VENDOR
	default "augentix"
config SYS_BOARD
	default "agt-ma804025-v1"
# include/config/SYS_CONFIG_NAME.h
config SYS_CONFIG_NAME
	default "hc1703-agt804-25"

endif
```

## bsp/sdk/bootloader/uboot/board/augentix/agt-ma804027-v1/Kconfig
```kconfig
if TARGET_AGT804_27

# board/SYS_VENDOR/SYS_BOARD
config SYS_VENDOR
	default "augentix"
config SYS_BOARD
	default "agt-ma804027-v1"
# include/config/SYS_CONFIG_NAME.h
config SYS_CONFIG_NAME
	default "hc1723-agt804-27"

endif
```

## bsp/sdk/bootloader/uboot/board/augentix/agt-ma804039-v1/Kconfig
```kconfig
if TARGET_AGT804_39

# board/SYS_VENDOR/SYS_BOARD
config SYS_VENDOR
	default "augentix"
config SYS_BOARD
	default "agt-ma804039-v1"
# include/config/SYS_CONFIG_NAME.h
config SYS_CONFIG_NAME
	default "hc1703-agt804-39"

endif
```

## bsp/sdk/bootloader/uboot/board/augentix/agt-ma804042-v1/Kconfig
```kconfig
if TARGET_AGT804_42

# board/SYS_VENDOR/SYS_BOARD
config SYS_VENDOR
	default "augentix"
config SYS_BOARD
	default "agt-ma804042-v1"
# include/config/SYS_CONFIG_NAME.h
config SYS_CONFIG_NAME
	default "hc1705-agt804-42"

endif

if TARGET_AGT705_2

# board/SYS_VENDOR/SYS_BOARD
config SYS_VENDOR
	default "augentix"
config SYS_BOARD
	default "agt-ma804042-v1"
# include/config/SYS_CONFIG_NAME.h
config SYS_CONFIG_NAME
	default "hc1705-agt705-2"

endif
```

## bsp/sdk/bootloader/uboot/board/augentix/agt-ma804045-v1/Kconfig
```kconfig
if TARGET_AGT804_45

# board/SYS_VENDOR/SYS_BOARD
config SYS_VENDOR
	default "augentix"
config SYS_BOARD
	default "agt-ma804045-v1"
# include/config/SYS_CONFIG_NAME.h
config SYS_CONFIG_NAME
	default "hc1703l-agt804-45"

endif
```
