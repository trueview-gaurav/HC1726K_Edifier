## bsp/sdk/bootloader/uboot/dummy.its
```
/dts-v1/;
/ {
	description = "dummy";
	#address-cells = <1>;
	images {
		kernel-1 {
			data = /incbin/("dummy.its");
			signature-1 {
				algo = "sha256,rsa2048";
				key-name-hint = "key3";
			};
		};
	};
	configurations {
		default = "conf-1";
		conf-1 {
			kernel = "kernel-1";
		};
	};
};
```
