## bsp/sdk/bootloader/uboot_upstream_sync/arch/arm/mach-augentix/sapporo/Kconfig
```kconfig
if AUGENTIX_SOC_SAPPORO

config CPU_V7_HAS_NONSEC
	default y

source "board/augentix/sapporo/Kconfig"

endif
```

## bsp/sdk/bootloader/uboot_upstream_sync/board/augentix/common/Kconfig
```kconfig
# Shared board settings.

config EFUSE_FSM_AUTOBURN
	bool "Enable eFuse Auto-Burn"
	select MMC
	select DM_MMC
	select MMC_DW
	select BOUNCE_BUFFER
	select FS_FAT
	select BOARD_LATE_INIT
	select ARM_SMCCC if AUGENTIX_SOC_SAPPORO
	default n
	help
	  Enable automatic eFuse burning during factory boot when factory_mode=1.
	  SPL eFuse API table at SPL+0x60 (0xFFE00860) is always built-in.

config EB_SMC
	bool
	default y if ARM_SMCCC && AUGENTIX_OPTEE
	help
	  Route the eFuse ops through OP-TEE. Unset reaches the controller
	  registers directly at EB_CTRL_BASE.
```

## bsp/sdk/bootloader/uboot_upstream_sync/board/augentix/kyoto/Kconfig
```kconfig
if TARGET_AUGENTIX_KYOTO

config SYS_VENDOR
	default "augentix"
config SYS_BOARD
	default "kyoto"
config SYS_CONFIG_NAME
	default "augentix_common"

source "board/augentix/common/Kconfig"

endif
```

## bsp/sdk/bootloader/uboot_upstream_sync/board/augentix/sapporo/Kconfig
```kconfig
if TARGET_AUGENTIX_SAPPORO

config SYS_VENDOR
	default "augentix"
config SYS_BOARD
	default "sapporo"
config SYS_CONFIG_NAME
	default "augentix_common"

source "board/augentix/common/Kconfig"

endif
```

## bsp/sdk/bootloader/uboot_upstream_sync/configs/hc1705k-agt705-3_defconfig
```kconfig
CONFIG_ARM=y
CONFIG_ARCH_AUGENTIX=y
CONFIG_TARGET_AUGENTIX_KYOTO=y
CONFIG_SECURE_BOOT=y
CONFIG_DDR_TYPE_DDR2=y
CONFIG_DRAM_GENERIC_DDR2=y
CONFIG_DRAM_MTS_1333=y
CONFIG_ENV_SIZE=0x00010000
CONFIG_ENV_OFFSET=0x000F0000
CONFIG_ENV_SECT_SIZE=0x00001000
CONFIG_DEFAULT_DEVICE_TREE="hc1705k-agt705-3"
CONFIG_SYS_LOAD_ADDR=0x01000000
CONFIG_FIT=y
CONFIG_FIT_SIGNATURE=y
CONFIG_SYS_CBSIZE=256
# CONFIG_CMD_BOOTD is not set
# CONFIG_CMD_ELF is not set
# CONFIG_CMD_GO is not set
# CONFIG_CMD_IMI is not set
# CONFIG_CMD_XIMG is not set
CONFIG_CMD_ENV_FLAGS=y
CONFIG_CMD_I2C=y
# CONFIG_CMD_LOADB is not set
# CONFIG_CMD_LOADS is not set
CONFIG_CMD_MMC=y
CONFIG_CMD_PART=y
CONFIG_CMD_NFS=y
CONFIG_CMD_PING=y
CONFIG_CMD_CACHE=y
CONFIG_CMD_FAT=y
CONFIG_CMD_FS_GENERIC=y
CONFIG_CMD_MTDPARTS=y
CONFIG_MTDIDS_DEFAULT="nor0=nor_flash"
CONFIG_MTDPARTS_DEFAULT="mtdparts=nor_flash:960k(boot),64k(bootenv),6m(linux),20m(rootfs),5m(usrdata)"
CONFIG_ENV_OVERWRITE=y
CONFIG_ENV_IS_IN_SPI_FLASH=y
CONFIG_UDP_CHECKSUM=y
CONFIG_DM_WARN=y
CONFIG_SYS_I2C_LEGACY=y
CONFIG_SYS_I2C_AUGENTIX=y
CONFIG_MMC_DW=y
CONFIG_FAT_WRITE=y
```

## bsp/sdk/bootloader/uboot_upstream_sync/configs/hc1706k-agt706-2_defconfig
```kconfig
CONFIG_ARM=y
CONFIG_ARCH_AUGENTIX=y
CONFIG_CPU_LOW_SPEED=y
CONFIG_SECURE_BOOT=y
CONFIG_DDR_TYPE_DDR2=y
CONFIG_DRAM_GENERIC_DDR2=y
CONFIG_DRAM_MTS_800=y
CONFIG_AUGENTIX_KERNEL_MAX_SIZE=0x00300000
CONFIG_AUGENTIX_SLOT_AB=y
CONFIG_AUGENTIX_OPTEE=y
CONFIG_EFUSE_FSM_AUTOBURN=y
CONFIG_ENV_SIZE=0x00010000
CONFIG_ENV_OFFSET=0x000F0000
CONFIG_ENV_SECT_SIZE=0x00001000
CONFIG_DEFAULT_DEVICE_TREE="hc1706k-agt706-2"
CONFIG_SYS_LOAD_ADDR=0x01000000
CONFIG_FIT=y
CONFIG_FIT_SIGNATURE=y
CONFIG_SYS_CBSIZE=256
# CONFIG_CMD_BOOTD is not set
# CONFIG_CMD_ELF is not set
# CONFIG_CMD_GO is not set
# CONFIG_CMD_IMI is not set
# CONFIG_CMD_XIMG is not set
CONFIG_CMD_ENV_FLAGS=y
# CONFIG_CMD_LOADB is not set
# CONFIG_CMD_LOADS is not set
CONFIG_CMD_MMC=y
CONFIG_CMD_PART=y
# CONFIG_CMD_ECHO is not set
CONFIG_CMD_NFS=y
CONFIG_CMD_PING=y
CONFIG_CMD_CACHE=y
CONFIG_CMD_SMC=y
CONFIG_CMD_FAT=y
CONFIG_CMD_FS_GENERIC=y
CONFIG_CMD_MTDPARTS=y
CONFIG_MTDIDS_DEFAULT="nor0=nor_flash"
CONFIG_MTDPARTS_DEFAULT="mtdparts=nor_flash:960k(boot),64k(bootenv),3m(linux_0),10752k(rootfs_0),3m(linux_1),10752k(rootfs_1),2m(usrdata),960k(tee_0),960k(tee_1)"
CONFIG_ENV_OVERWRITE=y
CONFIG_ENV_IS_IN_SPI_FLASH=y
CONFIG_UDP_CHECKSUM=y
CONFIG_DM_WARN=y
# CONFIG_SPL_SYS_NS16550_SERIAL is not set
CONFIG_FAT_WRITE=y
```

## bsp/sdk/bootloader/uboot_upstream_sync/configs/hc1726-agt726-10_defconfig
```kconfig
CONFIG_ARM=y
CONFIG_ARCH_AUGENTIX=y
CONFIG_FLASH_NAND=y
CONFIG_DRAM_MTS_1333=y
CONFIG_DRAM_CAPACITY=128
CONFIG_AUGENTIX_FLASH_CAPACITY_MB=128
CONFIG_AUGENTIX_KERNEL_MAX_SIZE=0x00800000
CONFIG_AUGENTIX_ROOTFS_MTD_ID=4
CONFIG_AUGENTIX_SLOT_AB=y
CONFIG_AUGENTIX_KERNEL_1_OFFSET=0x03900000
CONFIG_AUGENTIX_ROOTFS_1_MTD_ID=6
CONFIG_ROOTFS_UBIFS=y
CONFIG_AUGENTIX_FASTBOOT=y
CONFIG_EARLYAUDIO=y
CONFIG_AUGENTIX_EARLY_VIDEO_PATH0_WIDTH=2592
CONFIG_AUGENTIX_EARLY_VIDEO_PATH0_HEIGHT=1944
CONFIG_AUGENTIX_EARLY_VB_SIZE=15
CONFIG_AUGENTIX_EARLY_VB_PATH0_SIZE=15
CONFIG_AUGENTIX_CAMERA_FPS=25
CONFIG_AUGENTIX_IR_CUT_MODE=1
CONFIG_AUGENTIX_IR_CUT_GPIO_1=41
CONFIG_ADC_AUGENTIX_V2=y
CONFIG_ENV_RANGE=0x00040000
CONFIG_ENV_OFFSET_REDUND=0x000C0000
CONFIG_ENV_SIZE=0x00020000
CONFIG_ENV_OFFSET=0x00080000
CONFIG_DEFAULT_DEVICE_TREE="hc1726-agt726-10"
CONFIG_SYS_LOAD_ADDR=0x01000000
CONFIG_SYS_CBSIZE=256
CONFIG_CMD_MMC=y
CONFIG_CMD_PART=y
CONFIG_CMD_NFS=y
CONFIG_CMD_PING=y
CONFIG_CMD_CACHE=y
CONFIG_CMD_FAT=y
CONFIG_CMD_FS_GENERIC=y
CONFIG_CMD_MTDPARTS=y
CONFIG_MTDIDS_DEFAULT="spi-nand0=nand_flash"
CONFIG_MTDPARTS_DEFAULT="mtdparts=nand_flash:512k(boot),256k(bootenv_0),256k(bootenv_1),8m(linux_0),48m(rootfs_0),8m(linux_1),48m(rootfs_1),8m(usrdata),7m(calib)"
CONFIG_ENV_CALLBACK_LIST_STATIC="bootargs:bootargs_h"
CONFIG_ENV_OVERWRITE=y
CONFIG_ENV_IS_IN_MTD=y
CONFIG_ENV_REDUNDANT=y
CONFIG_ENV_MTD_DEV="spi-nand0"
CONFIG_UDP_CHECKSUM=y
CONFIG_DM_WARN=y
CONFIG_SYS_I2C_LEGACY=y
CONFIG_SYS_I2C_AUGENTIX=y
CONFIG_MMC_DW=y
CONFIG_BAUDRATE=460800
# CONFIG_SPL_SYS_NS16550_SERIAL is not set
CONFIG_FAT_WRITE=y
```

## bsp/sdk/bootloader/uboot_upstream_sync/configs/hc1726-agt726-2_defconfig
```kconfig
CONFIG_ARM=y
CONFIG_ARCH_AUGENTIX=y
CONFIG_EMMC=y
CONFIG_DRAM_MTS_1333=y
CONFIG_DRAM_CAPACITY=128
CONFIG_AUGENTIX_SLOT_AB=y
CONFIG_AUGENTIX_FASTBOOT=y
CONFIG_EARLYAUDIO=y
CONFIG_AUGENTIX_EARLY_VB_SIZE=4
CONFIG_AUGENTIX_EARLY_VB_PATH0_SIZE=4
CONFIG_AUGENTIX_CAMERA_FPS=30
CONFIG_AUGENTIX_IR_CUT_MODE=1
CONFIG_AUGENTIX_IR_CUT_GPIO_1=41
CONFIG_ADC_AUGENTIX_V2=y
CONFIG_ENV_SIZE=0x10000
CONFIG_ENV_OFFSET=0x80000
CONFIG_DEFAULT_DEVICE_TREE="hc1726-agt726-2"
CONFIG_SYS_LOAD_ADDR=0x01000000
CONFIG_SYS_CBSIZE=256
# CONFIG_CMD_BOOTD is not set
# CONFIG_CMD_ELF is not set
# CONFIG_CMD_GO is not set
# CONFIG_CMD_IMI is not set
# CONFIG_CMD_XIMG is not set
# CONFIG_CMD_LOADB is not set
# CONFIG_CMD_LOADS is not set
CONFIG_CMD_MMC=y
CONFIG_CMD_PART=y
# CONFIG_CMD_SOURCE is not set
# CONFIG_CMD_NET is not set
CONFIG_CMD_CACHE=y
CONFIG_CMD_FAT=y
CONFIG_CMD_FS_GENERIC=y
CONFIG_ENV_CALLBACK_LIST_STATIC="bootargs:bootargs_h"
CONFIG_ENV_OVERWRITE=y
CONFIG_ENV_IS_IN_MMC=y
CONFIG_UDP_CHECKSUM=y
CONFIG_DM_WARN=y
CONFIG_SYS_I2C_LEGACY=y
CONFIG_SYS_I2C_AUGENTIX=y
CONFIG_MMC_DW=y
CONFIG_BAUDRATE=460800
# CONFIG_SPL_SYS_NS16550_SERIAL is not set
CONFIG_FAT_WRITE=y
```

## bsp/sdk/bootloader/uboot_upstream_sync/configs/hc1726-agt726-4_defconfig
```kconfig
CONFIG_ARM=y
CONFIG_ARCH_AUGENTIX=y
CONFIG_SECURE_BOOT=y
CONFIG_AGTX_EMAC_CLK_O_50M=y
CONFIG_DRAM_MTS_1333=y
CONFIG_DRAM_CAPACITY=128
CONFIG_AUGENTIX_FLASH_CAPACITY_MB=16
CONFIG_AUGENTIX_KERNEL_MAX_SIZE=0x00300000
CONFIG_AUGENTIX_ROOTFS_MTD_ID=5
CONFIG_AUGENTIX_ROOTFS_1_MTD_ID=5
CONFIG_AUGENTIX_SLOT_AB=y
CONFIG_AUGENTIX_OPTEE=y
CONFIG_AUGENTIX_TEE_0_OFFSET=0x000F00000
CONFIG_AUGENTIX_TEE_1_OFFSET=0x000F00000
CONFIG_KERNEL_OFFSET=0x00100000
CONFIG_AUGENTIX_KERNEL_1_OFFSET=0x00100000
CONFIG_EFUSE_FSM_AUTOBURN=y
CONFIG_ENV_SIZE=0x00010000
CONFIG_ENV_OFFSET=0x00070000
CONFIG_ENV_SECT_SIZE=0x00001000
CONFIG_DEFAULT_DEVICE_TREE="hc1726-agt726-4"
CONFIG_SYS_LOAD_ADDR=0x01000000
CONFIG_FIT=y
CONFIG_FIT_SIGNATURE=y
CONFIG_SYS_CBSIZE=256
CONFIG_CMD_ENV_FLAGS=y
CONFIG_CMD_MMC=y
CONFIG_CMD_PART=y
CONFIG_CMD_NFS=y
CONFIG_CMD_PING=y
CONFIG_CMD_CACHE=y
CONFIG_CMD_SMC=y
CONFIG_CMD_FAT=y
CONFIG_CMD_FS_GENERIC=y
CONFIG_CMD_MTDPARTS=y
CONFIG_MTDIDS_DEFAULT="nor0=nor_flash"
CONFIG_MTDPARTS_DEFAULT="mtdparts=nor_flash:384k(boot),64k(factory),64k(bootenv),512k(config),3m(linux),2m(rootfs),9216k(appfs),896k(tee)"
CONFIG_ENV_OVERWRITE=y
CONFIG_ENV_IS_IN_SPI_FLASH=y
CONFIG_UDP_CHECKSUM=y
CONFIG_DM_WARN=y
# CONFIG_SPL_SYS_NS16550_SERIAL is not set
CONFIG_FAT_WRITE=y
CONFIG_ETH=n
CONFIG_DWC_ETH_QOS=n
CONFIG_PHYLIB=n
CONFIG_CMD_NET=n
CONFIG_CMD_BOOTP=n
CONFIG_CMD_TFTPBOOT=n
CONFIG_CMD_NFS=n
CONFIG_CMD_PING=n
CONFIG_BOOTM_PLAN9=n
CONFIG_BOOTM_RTEMS=n
CONFIG_BOOTM_VXWORKS=n
CONFIG_REGEX=n
CONFIG_LIB_RAND=n
CONFIG_ZLIB=n
CONFIG_GZIP=n
```

## bsp/sdk/bootloader/uboot_upstream_sync/configs/hc1726-emmc-nvspc_defconfig
```kconfig
CONFIG_ARM=y
CONFIG_ARCH_AUGENTIX=y
CONFIG_TEXT_BASE=0x03000400
CONFIG_EMMC=y
CONFIG_DRAM_MTS_1333=y
CONFIG_DRAM_CAPACITY=128
CONFIG_ENV_SIZE=0x10000
CONFIG_DEFAULT_DEVICE_TREE="hc1726-agt726-2"
CONFIG_SYS_LOAD_ADDR=0x01000000
CONFIG_SYS_CBSIZE=256
# CONFIG_CMD_BOOTD is not set
# CONFIG_CMD_ELF is not set
# CONFIG_CMD_GO is not set
# CONFIG_CMD_IMI is not set
# CONFIG_CMD_XIMG is not set
# CONFIG_CMD_EXPORTENV is not set
# CONFIG_CMD_IMPORTENV is not set
# CONFIG_CMD_EDITENV is not set
# CONFIG_CMD_SAVEENV is not set
# CONFIG_CMD_ENV_EXISTS is not set
CONFIG_CMD_GPT=y
# CONFIG_CMD_LOADB is not set
# CONFIG_CMD_LOADS is not set
CONFIG_CMD_MMC=y
CONFIG_CMD_PART=y
# CONFIG_CMD_ITEST is not set
# CONFIG_CMD_SOURCE is not set
# CONFIG_CMD_SETEXPR is not set
# CONFIG_CMD_NET is not set
CONFIG_CMD_AUGENTIX=y
CONFIG_ENV_OVERWRITE=y
CONFIG_MMC_DW=y
```

## bsp/sdk/bootloader/uboot_upstream_sync/configs/hc1726-str726-13_defconfig
```kconfig
CONFIG_ARM=y
CONFIG_ARCH_AUGENTIX=y
CONFIG_CPU_LOW_SPEED=y
CONFIG_SECURE_BOOT=y
CONFIG_FLASH_NAND=y
CONFIG_DRAM_MTS_1066=y
CONFIG_DRAM_CAPACITY=128
CONFIG_AUGENTIX_FLASH_CAPACITY_MB=128
CONFIG_AUGENTIX_KERNEL_MAX_SIZE=0x00700000
CONFIG_AUGENTIX_ROOTFS_MTD_ID=4
CONFIG_AUGENTIX_SLOT_AB=y
CONFIG_AUGENTIX_KERNEL_1_OFFSET=0x03700000
CONFIG_AUGENTIX_ROOTFS_1_MTD_ID=6
CONFIG_AUGENTIX_OPTEE=y
CONFIG_AUGENTIX_TEE_0_OFFSET=0x07D00000
CONFIG_AUGENTIX_TEE_1_OFFSET=0x07E00000
CONFIG_AUGENTIX_TEE_SIZE=0x00100000
CONFIG_ENV_RANGE=0x00040000
CONFIG_ENV_OFFSET_REDUND=0x000C0000
CONFIG_EFUSE_FSM_AUTOBURN=y
CONFIG_ENV_SIZE=0x00020000
CONFIG_ENV_OFFSET=0x00080000
CONFIG_DEFAULT_DEVICE_TREE="hc1726-str726-13"
CONFIG_SYS_LOAD_ADDR=0x01000000
CONFIG_FIT=y
CONFIG_FIT_SIGNATURE=y
CONFIG_SYS_CBSIZE=256
CONFIG_CMD_ENV_FLAGS=y
CONFIG_CMD_MMC=y
CONFIG_CMD_PART=y
CONFIG_CMD_NFS=y
CONFIG_CMD_PING=y
CONFIG_CMD_CACHE=y
CONFIG_CMD_SMC=y
CONFIG_CMD_FAT=y
CONFIG_CMD_FS_GENERIC=y
CONFIG_CMD_MTDPARTS=y
CONFIG_MTDIDS_DEFAULT="spi-nand0=nand_flash"
CONFIG_MTDPARTS_DEFAULT="mtdparts=nand_flash:512k(boot),256k(bootenv_0),256k(bootenv_1),7m(linux_0),47m(rootfs_0),7m(linux_1),47m(rootfs_1),8m(usrdata),8m(calib),1m(tee_0),1m(tee_1)"
CONFIG_ENV_OVERWRITE=y
CONFIG_ENV_IS_IN_MTD=y
CONFIG_ENV_REDUNDANT=y
CONFIG_ENV_MTD_DEV="spi-nand0"
CONFIG_UDP_CHECKSUM=y
CONFIG_DM_WARN=y
# CONFIG_SPL_SYS_NS16550_SERIAL is not set
CONFIG_FAT_WRITE=y
```

## bsp/sdk/kernel/linux_6.1.102/arch/arm/boot/fitImage.its
```
/dts-v1/;
/ {
	description = "fitImage";
	#address-cells = <1>;
	images {
		kernel-1 {
			description = "Linux kernel";
			data = /incbin/("./zImage.bin");
			type = "kernel";
			arch = "arm";
			os = "linux";
			compression = "none";
			load = <0x010000BC>;
			entry = <0x010000BC>;
			signature-1 {
				algo = "sha256,rsa2048";
				key-name-hint = "key3";
			};
		};
		script-1 {
			description = "U-boot environment script";
				data = /incbin/("./verity_script");
				type = "script";
				compression = "none";
				signature-1 {
					algo = "sha256,rsa2048";
					key-name-hint = "key3";
				};
		};
	};
	configurations {
		default = "conf-1";
		conf-1 {
			kernel = "kernel-1";
		};
	};
};
```

## bsp/sdk/kernel/linux_6.1.102/arch/arm/mach-augentix/Kconfig
```kconfig
config VB_SIZE_MB
	int "Video buffer size in MB"
	range 0 512
	default 64
	depends on ARCH_AUGENTIX
	help
	  Select the video buffer size.

menuconfig ARCH_AUGENTIX
	bool "Augentix SoC family" if ARCH_MULTI_V7
	depends on MMU
	select ARM_AMBA
	select ARM_GIC
	select CLKSRC_MMIO
	select DMADEVICES
	select PINCTRL
	help
	  Support for Augentix SoCs.

if ARCH_AUGENTIX

config MACH_HC17XX
	bool "Augentix HC17XX SoC"
	default y

if MACH_HC17XX

config AUGENTIX_AMP
   	bool "Augentix AMP architecture"
	default n
	depends on ARCH_AUGENTIX

config SAPPORO
	bool "Augentix sapporo"
	depends on ARCH_AUGENTIX

config KAMO
	bool "Augentix kamo"
	depends on ARCH_AUGENTIX

config OSAKA
	bool "Augentix osaka"
	depends on ARCH_AUGENTIX

endif

endif
```
