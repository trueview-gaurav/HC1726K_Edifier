## bsp/sdk/kernel/remote/Kconfig
```kconfig
mainmenu "Augentix SDK Remote Configuration"

source "baremetal/Kconfig"
source "freertos/Kconfig"
source "library/Kconfig"
```

## bsp/sdk/kernel/remote/baremetal/Kconfig
```kconfig
menu "baremetal"

config BAREMETAL_CM0_CM4
    bool "Cortex-M0/M4 baremetal support"
    default n

endmenu
```
