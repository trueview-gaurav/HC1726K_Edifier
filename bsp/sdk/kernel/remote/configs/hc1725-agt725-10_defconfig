## bsp/sdk/kernel/remote/freertos/Kconfig
```kconfig
menu "freertos"

config FREERTOS
        bool "FreeRTOS"
        default n

endmenu
```

## bsp/sdk/kernel/remote/library/Kconfig
```kconfig
menu "library"

choice
	prompt "neural network inference backend"
	depends on FREERTOS

	config LIBNCNN
		bool "use ncnn"

	config LIBTFLITE_MICRO
		bool "use microlite"
endchoice

config LIBROSA
	bool "librosa"
	default n
	depends on LIBNCNN

config EARLY_DETECT
	bool "support early ai detect in fastboot"
	default n
	depends on LIBNCNN

config EARLY_OD
	bool "support ODv5 in fastboot"
	default n
	depends on EARLY_DETECT

config LIBCPVS
	bool "libcpvs"
	default y

config LIBMETAL
	bool "libmetal"
	depends on FREERTOS

config LIBOPEN_AMP
	bool "libopen_amp"
	depends on FREERTOS
	select LIBMETAL

config LIBAMPC
	bool "libampc"
	depends on FREERTOS
	select LIBMETAL
	select LIBOPEN_AMP

endmenu
```

## bsp/sdk/sample/ampc/library/Kconfig
```kconfig
menu "library"

config LIBAMPC
	bool "libampc"
	select LIBMETAL
	select LIBOPEN_AMP
	default n

config LIBOPEN_AMP
	bool "libopen_amp"
	select LIBMETAL
	default n

config LIBMETAL
	bool "libmetal"
	default n

endmenu
```

## bsp/sdk/sample/demo/Kconfig
```kconfig
mainmenu "Augentix SDK Core Sample Configuration"

source "ai/Kconfig"

source "audio/Kconfig"

source "display/Kconfig"

source "utils/Kconfig"

source "video/Kconfig"
```

## bsp/sdk/sample/demo/ai/Kconfig
```kconfig
menu "ai"

config LIBEAIF
	bool "libeaif"
	select LIBINF
	default y

if LIBEAIF
source ai/libeaif/Kconfig
endif

config LIBINF
	bool "libinf"
	default y

if LIBINF
source ai/libinf/Kconfig
endif

config SAMPLE_DEMO_VFTR_DUMP
	bool "vftr_dump"
	default y
	select LIBEAIF
	select LIBINF
	help
		A debugging utility for IVA applications.

config SAMPLE_DEMO_VFTR_DUMP_SUPPORT_SEI
	bool "Send inference result through RTSP"
	default y
	depends on SAMPLE_DEMO_VFTR_DUMP

menuconfig SAMPLE_DEMO_AROI_DEMO
	bool "aroi_demo"
	default y
	help
		Sample program to demonstrate how to use Automatic Region-of-Interest.

config SAMPLE_DEMO_AROI_SUPPORT_SEI
	bool "Send inference result through RTSP"
	default y
	depends on SAMPLE_DEMO_AROI_DEMO

config SAMPLE_DEMO_PTZ_SUPPORT
	bool "support ptz"
	default n
	depends on SAMPLE_DEMO_AROI_DEMO

config SAMPLE_DEMO_AUTO_TRACKING
	bool "auto_tracking"
	select LIBMOTOR
	select LIBSAMPLE
	default n

menuconfig SAMPLE_DEMO_BM_DEMO
	bool "bm_demo"
	default y
	help
		Sample program to demonstrate how to implement baby monitor.

config SAMPLE_DEMO_BM_SUPPORT_SEI
	bool "Send inference result through RTSP"
	default y
	depends on SAMPLE_DEMO_BM_DEMO

menuconfig SAMPLE_DEMO_DK_DEMO
	bool "dk_demo"
	default y
	help
		Sample program to demonstrate how to use Door Keeper.

config SAMPLE_DEMO_DK_SUPPORT_SEI
	bool "Send inference result through RTSP"
	default y
	depends on SAMPLE_DEMO_DK_DEMO

menuconfig SAMPLE_DEMO_EF_DEMO
	bool "ef_demo"
	default y
	help
		Sample program to demonstrate how to use Electronic Fence.

config SAMPLE_DEMO_EF_SUPPORT_SEI
	bool "Send inference result through RTSP"
	default y
	depends on SAMPLE_DEMO_EF_DEMO

config SAMPLE_DEMO_EF_SHD_SUPPORT
	bool "Support shaking object detection"
	default y
	depends on SAMPLE_DEMO_EF_DEMO

menuconfig SAMPLE_DEMO_FACEDET_DEMO
	bool "facedet_demo"
	select LIBEAIF
	default y
	help
		Sample program to demonstrate how to use Face Detection.

config SAMPLE_DEMO_FACEDET_SUPPORT_SEI
	bool "Send inference result through RTSP"
	default y
	depends on SAMPLE_DEMO_FACEDET_DEMO

menuconfig SAMPLE_DEMO_FACERECO_DEMO
	bool "facereco_demo"
	select LIBEAIF
	default y
	help
		Sample program to demonstrate how to use Face Recognition.

config SAMPLE_DEMO_FACERECO_SUPPORT_SEI
	bool "Send inference result through RTSP"
	default y
	depends on SAMPLE_DEMO_FACERECO_DEMO

menuconfig SAMPLE_DEMO_FLD_DEMO
	bool "fld_demo"
	default y
	help
		Sample program to demonstrate how to use Fall Down Detection.

config SAMPLE_DEMO_FLD_SUPPORT_SEI
	bool "Send inference result through RTSP"
	default y
	depends on SAMPLE_DEMO_FLD_DEMO

menuconfig SAMPLE_DEMO_LOD_DEMO
	bool "lod_demo"
	default n
	help
		Sample program to demonstrate how to implement Left-Object Detection.

config SAMPLE_DEMO_LOD_SUPPORT_SEI
	bool "Send inference result through RTSP"
	default y
	depends on SAMPLE_DEMO_LOD_DEMO

menuconfig SAMPLE_DEMO_EAI_DEMO
	bool "install eai demo"
	default n
	help
		Sample program to demonstrate how to use multi-sensor iva demo.

if SAMPLE_DEMO_EAI_DEMO

config SAMPLE_DEMO_EAI_HD_DEMO
	bool "eai_hd_demo"
	default y
	help
		Sample program to demonstrate how to use multi-sensor Human Detection.

config SAMPLE_DEMO_EAI_HD_SUPPORT_SEI
	bool "Send inference result through RTSP"
	default y
	depends on SAMPLE_DEMO_EAI_HD_DEMO

endif

menuconfig SAMPLE_DEMO_HD_DEMO
	bool "hd_demo"
	select LIBEAIF
	default y
	help
		Sample program to demonstrate how to use Human Detection.

config SAMPLE_DEMO_HD_SUPPORT_SEI
	bool "Send inference result through RTSP"
	default y
	depends on SAMPLE_DEMO_HD_DEMO

config SAMPLE_DEMO_LSD_DEMO
	bool "lsd_demo"
	default y
	help
		Sample program to demonstrate how to use Loud Sound Detection.

config SAMPLE_DEMO_SD_DEMO
	bool "sd_demo"
	default n
	help
		Sample program to demonstrate how to use Sound Detection.

config SAMPLE_DEMO_SD_DEMO_REMOTE_CORE
	bool "sd_demo use remote core"
	depends on SAMPLE_DEMO_SD_DEMO
	default n

config SAMPLE_DEMO_SD_DEMO_TFLITE_OPTIM
	bool "sd_demo: use optimized (slim) TFLite engine"
	depends on SAMPLE_DEMO_SD_DEMO && !SAMPLE_DEMO_SD_DEMO_REMOTE_CORE
	default y
	help
		Link libaftr_cd (the CD v2.0 / YAM Net backend) against the
		optimized libtensorflow-lite-optim engine (~853KB deployed).
		Unset to fall back to the full libtensorflow-lite (~2.8MB) if a
		future model needs an op the slim engine strips out.
		The RTOS remote-core variant uses SVM and ignores this option.

menuconfig SAMPLE_DEMO_MD_DEMO
	bool "md_demo"
	default y
	help
		Sample program to demonstrate how to use Motion Detection.

config SAMPLE_DEMO_MD_SUPPORT_SEI
	bool "Send inference result through RTSP"
	default y
	depends on SAMPLE_DEMO_MD_DEMO

config SAMPLE_DEMO_MD_SHD_SUPPORT
	bool "Support shaking object detection"
	default y
	depends on SAMPLE_DEMO_MD_DEMO

menuconfig SAMPLE_DEMO_OD_DEMO
	bool "od_demo"
	default y
	help
		OD demo program.

config SAMPLE_DEMO_OD_SUPPORT_SEI
	bool "Send inference result through RTSP"
	default y
	depends on SAMPLE_DEMO_OD_DEMO
	help
		Enable when od_demo needs to generate SEI.

config SAMPLE_DEMO_OD_UTILS
	bool "Build utils"
	default n
	depends on SAMPLE_DEMO_OD_DEMO
	help
		A utility to demonstrate object detection.

menuconfig SAMPLE_DEMO_PFM_DEMO
	bool "pfm_demo"
	default y
	help
		Sample program to demonstrate how to use Pet Feeding Monitor.

config SAMPLE_DEMO_PFM_SUPPORT_SEI
	bool "Send inference result through RTSP"
	default y
	depends on SAMPLE_DEMO_PFM_DEMO

menuconfig SAMPLE_DEMO_PKG_DEMO
	bool "pkg_demo"
	default n
	help
		Sample program to demonstrate how to use Package Detection.

config SAMPLE_DEMO_PKG_SUPPORT_SEI
	bool "Send inference result through RTSP"
	default y
	depends on SAMPLE_DEMO_PKG_DEMO

menuconfig SAMPLE_DEMO_TD_DEMO
	bool "td_demo"
	default y
	help
		Sample program to demonstrate how to use Tamper Detection.

config SAMPLE_DEMO_TD_SUPPORT_SEI
	bool "Send inference result through RTSP"
	default y
	depends on SAMPLE_DEMO_TD_DEMO

config AOV_BLOCK_BY_OBJECT
    bool "AOV block by object"
    default n
    depends on SAMPLE_DEMO_OD_SUPPORT_SEI


endmenu
```

## bsp/sdk/sample/demo/audio/Kconfig
```kconfig
menu "audio"

config LIBADO
	bool "libado"
	default n

config SAMPLE_DEMO_ACTL
	bool "actl"
	default y

config SAMPLE_DEMO_G726
	bool "g726"
	default y

endmenu
```

## bsp/sdk/sample/demo/display/Kconfig
```kconfig
menu "display"

config SAMPLE_DEMO_DD_DEMO
	bool "dd_demo"
	default n
	help
		Sample program to demonstrate demo of decoder and display.

config SAMPLE_DEMO_DFB_DEMO
	bool "install directfb-demo for display test"
	default n

config SAMPLE_DEMO_GTK3_DEMO_GUI
	bool "gtk3 demo gui"
	default n
	help
		Need to install display related libs.

config SAMPLE_DEMO_SDL_DEMO
	bool "sdl_demo"
	default n

endmenu
```

## bsp/sdk/sample/demo/utils/Kconfig
```kconfig
menu "utils"

config SAMPLE_DEMO_MPI_SCRIPT
	bool "mpi_script"
	default y

config LIBFSINK
	bool "libfsink"
	default n

config LIBLPW
	bool "liblpw"
	default n

config SAMPLE_DEMO_LPW
	bool "Low power wireless"
	depends on LIBLPW
	default n

choice
	prompt "lpw module"
	default LPW_HI3861L
	depends on SAMPLE_DEMO_LPW

	config LPW_HI3861L
		bool "Hi3681L WiFi module"
	config LPW_AIW4211L
		bool "AIW4211L WiFi module"

endchoice

config SAMPLE_DEMO_LPW_SUPP
	bool "lpw_supplicant"
	depends on SAMPLE_DEMO_LPW
	default n
	help
		Sample program of lpw_supplicant to handle WiFi connection.

config SAMPLE_DEMO_HIBER_DEMO
	bool "hiber_demo"
	depends on SAMPLE_DEMO_LPW
	default n
	help
		Sample program to demonstrate how to use Lib LPW.

config SAMPLE_DEMO_LPW_FW_UPG
	bool "lpw_fw_upg"
	depends on SAMPLE_DEMO_LPW
	default n
	help
		Program to upgrade the firmware of Low Power Wireless (LPW) module.

config SAMPLE_DEMO_LPWIO
	bool "lpwio"
	depends on SAMPLE_DEMO_LPW
	default n
	help
		Program to measure Low Power Wireless (LPW) module's gpio value.

config LIBMOTOR
	bool "libmotor"
	select LIBSAMPLE
	default n

config LIBFOO
	bool "libfoo"
	default n
	help
	  Reference library.

config SAMPLE_DEMO_APPVERIFY
	bool "app_verify"
	default n
	help
		Verify the signature of the sample application at every boot.

endmenu
```
