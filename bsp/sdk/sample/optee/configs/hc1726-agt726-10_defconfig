## bsp/sdk/sample/optee/optee_client/Kconfig
```kconfig
config OPTEE_CLIENT
	bool "optee_client"
	default n

config TEE_SUPPLICANT_LOG_LEVEL
	int "tee-supplicant log level"
	depends on OPTEE_CLIENT
	range 0 4
	default "1"
	help
	  The log level of tee-supplicant, 0=ERROR, 1=WARNING,
	  2=INFO, 3=DEBUG, 4=VERBOSE.


config TEE_CLIENT_LOG_LEVEL
	int "tee client log level"
	depends on OPTEE_CLIENT
	range 0 4
	default "1"
	help
	  The log level of tee clients, 0=ERROR, 1=WARNING,
	  2=INFO, 3=DEBUG, 4=VERBOSE.
```

## bsp/sdk/sample/optee/optee_examples/Kconfig
```kconfig
config OPTEE_EXAMPLES
	bool "optee_example"
	default n

config HELLO_WORLD_EXAMPLE
	bool "tee hello_world example"
	depends on OPTEE_EXAMPLES
	default n

config AES_EXAMPLE
	bool "tee aes example"
	depends on OPTEE_EXAMPLES
	default n

config ACIPHER_EXAMPLE
	bool "tee acipher example"
	depends on OPTEE_EXAMPLES
	default n

config HOTP_EXAMPLE
	bool "tee hotp example"
	depends on OPTEE_EXAMPLES
	default n

config RANDOM_EXAMPLE
	bool "tee random example"
	depends on OPTEE_EXAMPLES
	default n

config SECURE_STORAGE_EXAMPLE
	bool "tee secure_storage example"
	depends on OPTEE_EXAMPLES
	default n

config USER_AUTH_AGTX_EXAMPLE
	bool "Augentix tee user_auth example"
	depends on OPTEE_EXAMPLES
	default n

config SECURE_STORAGE_AGTX_EXAMPLE
	bool "Augentix tee secure_storage example"
	depends on OPTEE_EXAMPLES
	default n
```

## bsp/toolchain/src/Sources/meta-qti-ipcam-toolchains/conf/distro/include/qti-ipcam-toolchain.inc
```bitbake
# Packaging / image features
PACKAGE_CLASSES ?= "package_rpm"
EXTRA_IMAGE_FEATURES ?= "debug-tweaks"

# libc policy
TCLIBC = "uclibc"

# prune distro features
DISTRO_FEATURES_remove = "x11 wayland gobject-introspection-data"

# skip unwanted toolchain extras
BBMASK += ".*/libgfortran_.*\.bb"
BBMASK += ".*/libgfortran\.inc"
BBMASK += ".*/binutils-cross-testsuite_.*\.bb$"
BBMASK += "meta-qti-ipcam-toolchains/recipes-devtools/binutils/binutils-cross-testsuite_.*\.bb"

# GCC 10.3 selection
GCCVERSION = "10.3%"
SDKGCCVERSION = "10.3%"

PREFERRED_VERSION_gcc = "10.3.%"
PREFERRED_VERSION_gcc-runtime = "10.3.%"
PREFERRED_VERSION_libgcc = "10.3.%"

PREFERRED_VERSION_gcc-cross-${TARGET_ARCH} = "10.3.%"
PREFERRED_VERSION_gcc-cross-initial-${TARGET_ARCH} = "10.3.%"
PREFERRED_VERSION_gcc-crosssdk-${SDK_ARCH} = "10.3.%"

# SDK bootstrap stays on 5.3 to avoid loops
PREFERRED_VERSION_gcc-crosssdk-initial-${SDK_ARCH} = "5.3.%"
PREFERRED_VERSION_nativesdk-libgcc-initial = "5.3.%"

# SDK/package pruning
SDKIMAGE_FEATURES_remove = "dbg-pkgs src-pkgs doc-pkgs"
SDKIMAGE_FEATURES_remove = " dbg-pkgs tools-debug"
EXTRA_IMAGE_FEATURES_remove = " dbg-pkgs tools-debug debug-tweaks"
TOOLCHAIN_TARGET_TASK_remove = "packagegroup-core-standalone-sdk-target-dbg"

# ensure uclibc staticdev shipped
TOOLCHAIN_TARGET_TASK_append = " uclibc-staticdev"
TOOLCHAIN_TARGET_TASK_append = " libiconv libiconv-dev"
TOOLCHAIN_HOST_TASK_append = " nativesdk-isl"

BINUVERSION = "2.36%"
```

## bsp/toolchain/src/Sources/meta-qti-ipcam-toolchains/conf/distro/include/qti-ipcam-workarounds.inc
```bitbake
# SDK / nativesdk workarounds
EXTRA_OECONF_append_pn-nativesdk-db = " --disable-cxx --disable-stl"
EXTRA_OECONF_append_pn-nativesdk-libpcre = " --disable-cpp"

# binutils-cross-canadian (arm): disable gold
EXTRA_OECONF_append_pn-binutils-cross-canadian-arm = " --disable-gold"
```

## bsp/toolchain/src/Sources/meta-qti-ipcam-toolchains/conf/distro/qti-ipcam.conf
```bitbake
require conf/distro/poky.conf
require conf/distro/include/qti-ipcam-toolchain.inc
require conf/distro/include/qti-ipcam-workarounds.inc

DISTRO = "qti-ipcam"
DISTRO_NAME = "QTI-IPCAM"
DISTRO_VERSION = "1.0.0"

# target triplet vendor
TARGET_VENDOR = "-augentix"

# SDK host triplet vendor:
# SDK_VENDOR ?= "-pokysdk"
SDK_VENDOR = "-augentixsdk"

# Derive gnueabi triplet from TARGET_SYS (keep vendor, replace libc suffix)
QTI_IPCAM_GNUEABI_SYS = "${@((d.getVar('TARGET_SYS', True) or '')\
    .replace('uclibceabihf','gnueabihf')\
    .replace('uclibceabi','gnueabi'))}"

# make hash type to both
LINKER_HASH_STYLE = "both"
TARGET_LINK_HASH_STYLE = "-Wl,--hash-style=both"
```

## bsp/toolchain/src/Sources/meta-qti-ipcam-toolchains/conf/machine/qti-ipcam-cortexa7-soft.conf
```bitbake
require conf/machine/qti-ipcam-cortexa7.conf

# ---- Pure soft-float policy ----
DEFAULTTUNE = "cortexa7t"

# Add call convention to pure soft
TUNE_FEATURES_remove = "callconvention-hard callconvention-softfp"
TUNE_FEATURES_append = " callconvention-soft"

# Remove vfp to make TARGET_FPU to soft
TUNE_FEATURES_remove = "vfp"

# Clear -mfpu=vfp / softfp
TUNE_CCARGS_remove = " -mfpu=vfp -mfloat-abi=softfp -msoft-float"
TUNE_CCARGS_append = " -mfloat-abi=soft -mfpu=auto -msoft-float"

#Add cortexa7t2 to PACKAGE_EXTRA_ARCHS
PACKAGE_EXTRA_ARCHS_append = " cortexa7t2"

QTI_IPCAM_FLOATABI = "soft"
```

## build/build/menu/Config.in
```kconfig
#

mainmenu "Build Configuration"

source "build/menu/ipc.platform.h"

source "build/menu/ipc.hardware.h"

source "build/menu/ipc.flashchip.h"

source "build/menu/ipc.sensormodel.h"

source "build/menu/ipc.autolens.h"

source "build/menu/ipc.customer.h"

source "build/menu/ipc.project.h"

source "build/menu/ipc.release.h"
```
